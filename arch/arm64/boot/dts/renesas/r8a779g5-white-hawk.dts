// SPDX-License-Identifier: (GPL-2.0-only OR BSD-2-Clause)
/*
 * Device Tree Source for the R-Car V4H ES3.0 White Hawk board
 *
 * Copyright (C) 2024 Renesas Electronics Corp.
 */

/dts-v1/;
#include "r8a779g0-whitehawk.dts"
#include "r8a779g5.dtsi"

/ {
	model = "Renesas White Hawk board based on r8a779g5";
	compatible = "renesas,white-hawk", "renesas,r8a779g5",
		     "renesas,r8a779g0";
};
