/*
 * Device Tree Source for the V3M Starter Kit board on r8a7797 ES1.0
 *
 * Copyright (C) 2018 Renesas Electronics Corp.
 * Copyright (C) 2018 Cogent Embedded, Inc.
 *
 * This file is licensed under the terms of the GNU General Public License
 * version 2.  This program is licensed "as is" without any warranty of any
 * kind, whether express or implied.
 */

#include "r8a77970-v3msk.dts"
#include "r8a77970-es1.dtsi"

/ {
	model = "Renesas V3M Starter Kit board based on r8a7797 ES1.0";
};
