// SPDX-License-Identifier: (GPL-2.0-only OR BSD-2-Clause)
/*
 * UIO Device Tree Source for the R-Car V4M-7 Gray Hawk Single board
 *
 * Copyright (C) 2024 Renesas Electronics Corp.
 */

#include "r8a779h0-gray-hawk-uio-common.dtsi"

/ {
	model = "Renesas Gray Hawk Single board based on r8a779h2";
	compatible = "renesas,gray-hawk", "renesas,r8a779h2",
		     "renesas,r8a779h0";
};
