// SPDX-License-Identifier: (GPL-2.0-only OR BSD-2-Clause)
/*
 * Device Tree Source fragment for UIO support on the R-Car X5H (R8A78000) SoC
 *
 * Copyright (C) 2025 Renesas Electronics Corp.
 */

/dts-v1/;
#include "r8a78000-uio.dtsi"
#include "r8a78000-ironhide-common.dtsi"

/ {
	model = "Renesas Ironhide board based on r8a78000";
	compatible = "renesas,ironhide", "renesas,r8a78000", "renesas,r8a78000-uio";
};
