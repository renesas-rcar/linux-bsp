// SPDX-License-Identifier: GPL-2.0
/*
 * Device Tree Source for the White Hawk CPU board
 *
 * Copyright (C) 2021 Renesas Electronics Corp.
 */

#include "r8a779g0-rgid.dtsi"
#include "white-hawk-cpu-common-rgid.dtsi"

/ {
	model = "Renesas White Hawk CPU board";
	compatible = "renesas,whitehawk-cpu", "renesas,r8a779g0";
};
