// SPDX-License-Identifier: (GPL-2.0-only OR BSD-2-Clause)
/*
 * Device Tree Source for the R-Car V4H-7 (R8A779G3) SoC
 *
 * Copyright (C) 2024 Renesas Electronics Corp.
 */

#include "r8a779g0-rgid.dtsi"

/ {
	compatible = "renesas,r8a779g3", "renesas,r8a779g0";
};
