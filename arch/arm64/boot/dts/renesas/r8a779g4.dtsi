// SPDX-License-Identifier: (GPL-2.0-only OR BSD-2-Clause)
/*
 * Device Tree Source for the R-Car V4H (R8A779G4) SoC
 *
 * Copyright (C) 2024 Renesas Electronics Corp.
 */

#include <dt-bindings/clock/r8a779g0-cpg-mssr.h>
#include <dt-bindings/interrupt-controller/arm-gic.h>
#include <dt-bindings/power/r8a779g0-sysc.h>
#include <dt-bindings/ipmmu/rcar-ipmmu.h>

/ {
	compatible = "renesas,r8a779g4", "renesas,r8a779g0";

	cluster1_opp: opp_table10 {
		opp-1400000000 {
			opp-hz = /bits/ 64 <1400000000>;
			opp-microvolt = <825000>;
			clock-latency-ns = <500000>;
		};

		/delete-node/opp-1500000000;
		/delete-node/opp-1700000000;
		/delete-node/opp-1800000000;
	};
};
