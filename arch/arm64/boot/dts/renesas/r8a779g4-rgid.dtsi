// SPDX-License-Identifier: (GPL-2.0-only OR BSD-2-Clause)
/*
 * Device Tree Source for the R-Car V4H-5 (R8A779G4) SoC
 *
 * Copyright (C) 2024 Renesas Electronics Corp.
 */

#include "r8a779g0-rgid.dtsi"

/ {
	compatible = "renesas,r8a779g4", "renesas,r8a779g0";

	cluster1_opp: opp_table10 {
		opp-1400000000 {
			opp-hz = /bits/ 64 <1400000000>;
			opp-microvolt = <825000>;
			clock-latency-ns = <500000>;
		};

		/delete-node/opp-1500000000;
		/delete-node/opp-1700000000;
		/delete-node/opp-1800000000;
	};
};
