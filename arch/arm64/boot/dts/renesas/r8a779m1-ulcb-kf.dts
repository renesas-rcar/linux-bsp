// SPDX-License-Identifier: GPL-2.0
/*
 * Device Tree Source for the H3ULCB-2G Kingfisher board
 *
 * Copyright (C) 2021 Renesas Electronics Corp.
 */

#include "r8a779m1-ulcb.dts"
#include "ulcb-kf.dtsi"

/ {
	model = "Renesas H3ULCB-2G Kingfisher board based on r8a779m1";
	compatible = "shimafuji,kingfisher", "renesas,h3ulcb",
		     "renesas,r8a779m1", "renesas,r8a7795";
};

/* use CN11 instead default CN29/CN48 (H3 only) */
//#include "ulcb-kf-cn11.dtsi"
