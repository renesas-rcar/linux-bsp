// SPDX-License-Identifier: (GPL-2.0-only OR BSD-2-Clause)
/*
 * UIO Device Tree Source for the R-Car V4M-5 Gray Hawk Single board
 *
 * Copyright (C) 2025 Renesas Electronics Corp.
 */

/dts-v1/;
#include "r8a779h3-uio.dtsi"
#include "r8a779h3-gray-hawk-uio-common.dtsi"

/ {
	model = "Renesas Gray Hawk Single board based on r8a779h3";
	compatible = "renesas,gray-hawk", "renesas,r8a779h3",
		     "renesas,r8a779h0";

	gsx_opp_table: gsx-opp-table {
		compatible = "operating-points-v2";

		opp-750000000 {
			opp-hz = /bits/ 64 <750000000>;
			opp-microvolt = <830000>;
		};
	};
};

&gsx {
	operating-points-v2 = <&gsx_opp_table>;
};
