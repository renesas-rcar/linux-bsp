// SPDX-License-Identifier: (GPL-2.0-only OR BSD-2-Clause)
/*
 * Device Tree Source for the R-Car V4M Gray Hawk boards
 *
 * Copyright (C) 2023 Renesas Electronics Corp.
 */

/dts-v1/;
#include "r8a779h0-rgid.dtsi"
#include "r8a779h0-gray-hawk-common-rgid.dtsi"

/ {
	model = "Renesas Gray Hawk boards based on r8a779h0";
	compatible = "renesas,gray-hawk-breakout", "renesas,gray-hawk-cpu", "renesas,r8a779h0";
};
