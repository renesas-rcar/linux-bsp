/*
 * Device Tree Source for the Condor board on r8a7798 ES2.0
 *
 * Copyright (C) 2018 Renesas Electronics Corp.
 * Copyright (C) 2018 Cogent Embedded, Inc.
 *
 * This file is licensed under the terms of the GNU General Public License
 * version 2.  This program is licensed "as is" without any warranty of any
 * kind, whether express or implied.
 */

#include "r8a77980-condor.dts"
#include "r8a77980-es2.dtsi"

/ {
	model = "Renesas Condor board based on r8a7798 ES2.0";
};

&mmc0 {
	mmc-hs400-1_8v;
};
