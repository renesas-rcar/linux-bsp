// SPDX-License-Identifier: (GPL-2.0-only OR BSD-2-Clause)
/*
 * Device Tree Source for the Gray Hawk CPU board
 *
 * Copyright (C) 2023 Renesas Electronics Corp.
 */

#include "r8a779h0.dtsi"
#include "gray-hawk-cpu-common.dtsi"

/ {
	model = "Renesas Gray Hawk CPU board";
	compatible = "renesas,grayhawk-cpu", "renesas,r8a779h0";
};
