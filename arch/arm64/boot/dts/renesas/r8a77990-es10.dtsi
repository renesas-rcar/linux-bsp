// SPDX-License-Identifier: GPL-2.0
/*
 * Device Tree Source for the R-Car E3 (R8A77990) ES1.0 SoC
 *
 * Copyright (C) 2018 Renesas Electronics Corp.
 */

#include "r8a77990.dtsi"

&gsx {
	power-domains = <&sysc R8A77990_PD_3DG_A>;
};
