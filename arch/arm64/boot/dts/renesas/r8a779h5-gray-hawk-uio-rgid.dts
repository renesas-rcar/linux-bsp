// SPDX-License-Identifier: (GPL-2.0-only OR BSD-2-Clause)
/*
 * UIO Device Tree Source for the R-Car V4M-2 Gray Hawk Single board
 *
 * Copyright (C) 2024 Renesas Electronics Corp.
 */

/dts-v1/;
#include "r8a779h5-uio-rgid.dtsi"
#include "r8a779h5-gray-hawk-uio-common-rgid.dtsi"

/ {
	model = "Renesas Gray Hawk Single board based on r8a779h5";
	compatible = "renesas,gray-hawk", "renesas,r8a779h5",
		     "renesas,r8a779h0";
};
