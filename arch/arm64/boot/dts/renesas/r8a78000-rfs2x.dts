// SPDX-License-Identifier: GPL-2.0
/*
 * Device Tree Source for the RFS2X board based on R8A78000
 *
 * Copyright (C) 2025 Renesas Electronics Corp.
 */

/dts-v1/;
#include "r8a78000.dtsi"
#include "r8a78000-rfs2x-common.dtsi"

/ {
	model = "Renesas RFS2X for X5H based on r8a78000";
	compatible = "renesas,rfs2x", "renesas,r8a78000";
};
