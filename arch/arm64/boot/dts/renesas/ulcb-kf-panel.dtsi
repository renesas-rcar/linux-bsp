// SPDX-License-Identifier: GPL-2.0
/*
 * Device Tree Source for the Kingfisher (ULCB extension) LVDS panel
 *
 * Copyright (C) 2018-2020 Renesas Electronics Corp.
 * Copyright (C) 2018-2020 Cogent Embedded, Inc.
 */

&lvds {
	compatible = "panel-lvds";

	width-mm = <210>;
	height-mm = <158>;

	data-mapping = "jeida-24";

	panel-timing {
		/* 1280x800 @60Hz Boundary Devices BD101LCC1 compatible panel */
		clock-frequency = <65000000>;
		hactive = <1280>;
		vactive = <800>;
		hsync-len = <40>;
		hfront-porch = <80>;
		hback-porch = <40>;
		vfront-porch = <14>;
		vback-porch = <14>;
		vsync-len = <4>;
	};
};

&gpio2 {
	gpio@3 {
		gpio-hog;
		gpios = <3 GPIO_ACTIVE_HIGH>;
		output-high;
		line-name = "BL PWM 100%";
	};
};
