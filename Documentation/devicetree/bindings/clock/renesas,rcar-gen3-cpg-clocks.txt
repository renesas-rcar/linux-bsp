## Documentation/devicetree/bindings/pci/rcar-gen5-pcie6-host.yaml
```yaml
# SPDX-License-Identifier: (GPL-2.0-only OR BSD-2-Clause)
# Copyright (C) 2022 Renesas Electronics Corp.
%YAML 1.2
---
$id: http://devicetree.org/schemas/pci/rcar-gen4-pci-host.yaml#
$schema: http://devicetree.org/meta-schemas/core.yaml#

title: Renesas R-Car Gen5 PCIe 6.0 Host

maintainers:
  - Tin Tran <tin.tran.xk@renesas.com>

allOf:
  - $ref: snps,dw-pcie.yaml#

properties:
  compatible:
    items:
      - const: renesas,rcar-gen5-pcie6 # R-Car Gen5

  interrupts:
    maxItems: 9

  clocks:
    maxItems: 1

  power-domains:
    maxItems: 1

  resets:
    maxItems: 1

required:
  - compatible
  - reg
  - interrupts
  - clocks
  - power-domains

unevaluatedProperties: false

examples:

        pcie6: pcie6@0xDC000000 {
		compatible = "renesas,rcar-gen5-pcie6";
		bus-range = <0 0xff>;
		reg = <0x0 0xDC000000 0x0 0x1000000>, <0 0xDA000000 0 0x100000>;
		reg-names = "dbi", "config";
		#address-cells = <3>;
		#size-cells = <2>;
		device_type = "pci";
		ranges = <0x02000000 0x0 0x90000000 0x0 0xDA100000 0x0 0xF00000>;
		interrupts = <0 348 4>,
			     <0 349 4>,
			     <0 350 4>,
			     <0 354 4>,
			     <0 355 4>,
			     <0 355 4>,
			     <0 355 4>,
			     <0 355 4>,
			     <0 356 4>;
		interrupt-map-mask = <0 0 0 7>;
		interrupt-map = <0 0 0 1 &gic 0 0x38000000 0 348 4
				 0 0 0 2 &gic 0 0x38000000 0 349 4
				 0 0 0 3 &gic 0 0x38000000 0 350 4
				 0 0 0 4 &gic 0 0x38000000 0 354 4
				 0 0 0 4 &gic 0 0x38000000 0 355 4
				 0 0 0 4 &gic 0 0x38000000 0 355 4
				 0 0 0 4 &gic 0 0x38000000 0 355 4
				 0 0 0 4 &gic 0 0x38000000 0 355 4
				 0 0 0 4 &gic 0 0x38000000 0 356 4>;
		clocks = <&pcie_bus>;
		clock-names = "pcie_bus";
		#interrupt-cells = <1>;
		max-link-speed = <6>;
		num-lanes = <2>;
		#stream-id-cells = <1>;
		status = "okay";
        };
```

## Documentation/devicetree/bindings/pci/renesas,dw-pci-ep.yaml
```yaml
# SPDX-License-Identifier: (GPL-2.0-only OR BSD-2-Clause)
# Copyright (C) 2022 Renesas Electronics Corp.
%YAML 1.2
---
$id: http://devicetree.org/schemas/pci/renesas,dw-pci-ep.yaml#
$schema: http://devicetree.org/meta-schemas/core.yaml#

title: Renesas PCIe 4.0 endpoint controller

description:
Renesas PCIe 4.0 endpoint controller is based on the Synopsys DesignWare
PCI core. It shares common functions with the PCIe DesignWare core driver
and inherits common properties defined in
Documentation/devicetree/bindings/pci/designware-pcie.txt.

Required properties:
  compatible:
    enum:
      - renesas,r8a779a0-pcie-ep  # R-Car V3U
      - renesas,r8a779g0-pcie-ep  # R-Car V4H
  reg:
        description:
         Specifies offset and length of the register set for the device.
         According to the reg-names, appropriate register sets are required.
  reg-names:
      - items:
          - const: dbi
          - const: dbi2
          - const: shadow
		  - const: atu
		  - const: dma
		  - const: app
		  - const: phy
          - const: addr_space
  clocks:
        description:
         Contain an entry for each entry in clock-names.
  clock-names:
        description:
         Must include the following entries:
        "pcie"
        "pcie_bus"
  resets:
        description:
        A phandle to the reset line for PCIe glue layer including
        the host controller.
  interrupts:
        description:
        A list of interrupt specifiers. According to the
        interrupt-names, appropriate interrupts are required.
  interrupt-names:
        description:
         Must include the following entries:
         "dma" - DMA interrupt
         "msi" - MSI interrupt
  num-lanes:
        description:
         Number of lanes to use

examples:
	pciec0_ep: pciec0_ep@e65d0000 {
		compatible = "renesas,r8a779g0-pcie-ep";
		reg = <0 0xe65d0000 0 0x1000>, <0 0xe65d1000 0 0x1000>,
		      <0 0xe65d2000 0 0x1000>, <0 0xe65d3000 0 0x2000>,
		      <0 0xe65d5000 0 0x1200>, <0 0xe65d6200 0 0x0e00>,
		      <0 0xe65d7000 0 0x1000>, <0 0xfe000000 0 0x400000>;
		reg-names = "dbi", "dbi2",
		            "shadow", "atu",
		            "dma", "app",
		            "phy", "addr_space";
		interrupts = <GIC_SPI 449 IRQ_TYPE_LEVEL_HIGH>,
		             <GIC_SPI 450 IRQ_TYPE_LEVEL_HIGH>,
		             <GIC_SPI 451 IRQ_TYPE_LEVEL_HIGH>,
		             <GIC_SPI 452 IRQ_TYPE_LEVEL_HIGH>,
		             <GIC_SPI 453 IRQ_TYPE_LEVEL_HIGH>,
		             <GIC_SPI 454 IRQ_TYPE_LEVEL_HIGH>,
		             <GIC_SPI 455 IRQ_TYPE_LEVEL_HIGH>;
		interrupt-names = "msi", "dma", "err", "fatal",
		                  "nonfatal", "lp", "vndmsg";
		clocks = <&cpg CPG_MOD 624>,
		         <&pcie_bus_clk>;
		clock-names = "pcie0", "pcie_bus";
		power-domains = <&sysc R8A779G0_PD_ALWAYS_ON>;
		resets = <&cpg 624>;
		num-lanes = <2>;
		max-link-speed = <2>;
		num-ib-windows = <16>;
		num-ob-windows = <16>;
		status = "disabled";
	};
```

## Documentation/devicetree/bindings/pci/renesas,dw-pci-host.yaml
```yaml
# SPDX-License-Identifier: (GPL-2.0-only OR BSD-2-Clause)
# Copyright (C) 2021 Renesas Electronics Corp.
%YAML 1.2
---
$id: http://devicetree.org/schemas/pci/renesas,dw-pci-host.yaml#
$schema: http://devicetree.org/meta-schemas/core.yaml#

title: Renesas PCIe 4.0 host controller bindings

description:
Renesas PCIe 4.0 host controller is based on the Synopsys DesignWare PCI core.
It shares common functions with the PCIe DesignWare core driver and inherits
common properties defined in
Documentation/devicetree/bindings/pci/designware-pcie.txt.

Required properties:
  compatible:
    enum:
      - renesas,r8a779a0-pcie  # R-Car V3U
      - renesas,r8a779g0-pcie  # R-Car V4H
  reg:
	description:
	 Specifies offset and length of the register set for the device.
         According to the reg-names, appropriate register sets are required.
  reg-names:
	description:
	 Must include the following entries:
	 "dbi"    - controller configuration registers
	 "config" - PCIe configuration space
	 "atu"    - iATU registers for DWC version 4.80 or later
  bus-range:
	description:
	  PCI bus numbers covered (it is recommended for new devicetrees
	  to specify this property, to keep backwards compatibility a range of
	  0x00-0xff is assumed if not present)
  device_type:
	description:
	 Set to "pci"
  ranges:
	description:
	 Ranges for the PCI memory and I/O regions
  clocks:
	description:
	 Contain an entry for each entry in clock-names.
  clock-names:
	description:
	 Must include the following entries:
        "pcie"
        "pcie_bus"
  resets:
	description:
	A phandle to the reset line for PCIe glue layer including
        the host controller.
  interrupts:
	description:
	A list of interrupt specifiers. According to the
        interrupt-names, appropriate interrupts are required.
  interrupt-names:
	description:
	 Must include the following entries:
	 "dma" - DMA interrupt
	 "msi" - MSI interrupt
  num-lanes:
	description:
	 Number of lanes to use
  snps,enable-cdm-check:
	description:
	 This is a boolean property and if present enables
	 automatic checking of CDM (Configuration Dependent Module) registers
	 for data corruption. CDM registers include standard PCIe configuration
	 space registers, Port Logic registers, DMA and iATU (internal Address
	 Translation Unit) registers.

examples:
	pciec0: pcie@e65d0000 {
                compatible = "renesas,r8a779a0-pcie";
                reg = <0 0xe65d0000 0 0x3000>,
                      <0 0xe65d3000 0 0x2000>,
                      <0 0xe65d5000 0 0x1200>,
                      <0 0xe65d6200 0 0x0e00>,
                      <0 0xe65d7000 0 0x1000>,
                      <0 0xfe000000 0 0x10000>;
                reg-names = "dbi",
                            "atu",
                            "dma",
                            "app",
                            "phy",
                            "config";
                #address-cells = <3>;
                #size-cells = <2>;
                bus-range = <0x00 0xff>;
                device_type = "pci";
                          /* downstream IO (64 KB) */
                ranges = <0x81000000 0 0x00000000 0 0xfe020000 0 0x00010000
                          /* non-prefetchable memory (256 MB) */
                          0x82000000 0 0x30000000 0 0x30000000 0 0x10000000>;
                              /* Map all possible DDR as inbound ranges */
                dma-ranges = <0x42000000 0 0x40000000 0 0x40000000 0 0x80000000>;
                interrupts = <GIC_SPI 224 IRQ_TYPE_LEVEL_HIGH>,
                             <GIC_SPI 225 IRQ_TYPE_LEVEL_HIGH>,
                             <GIC_SPI 226 IRQ_TYPE_LEVEL_HIGH>,
                             <GIC_SPI 416 IRQ_TYPE_LEVEL_HIGH>,
                             <GIC_SPI 417 IRQ_TYPE_LEVEL_HIGH>,
                             <GIC_SPI 418 IRQ_TYPE_LEVEL_HIGH>,
                             <GIC_SPI 419 IRQ_TYPE_LEVEL_HIGH>;
                interrupt-names = "msi", "dma", "err", "fatal",
                                  "nonfatal", "lp", "vndmsg";
                #interrupt-cells = <1>;
                interrupt-map-mask = <0 0 0 7>;
                interrupt-map = <0 0 0 1 &gic GIC_SPI 224 IRQ_TYPE_LEVEL_HIGH
                                 0 0 0 2 &gic GIC_SPI 224 IRQ_TYPE_LEVEL_HIGH
                                 0 0 0 3 &gic GIC_SPI 224 IRQ_TYPE_LEVEL_HIGH
                                 0 0 0 4 &gic GIC_SPI 224 IRQ_TYPE_LEVEL_HIGH>;
                clocks = <&cpg CPG_MOD 624>,
                         <&pcie_bus_clk>;
                clock-names = "pcie",
                              "pcie_bus";
                power-domains = <&sysc R8A779A0_PD_ALWAYS_ON>;
                resets = <&cpg 624>;
                num-lanes = <2>;
                snps,enable-cdm-check = "true";
                max-link-speed = <2>;
                status = "disabled";
        };
```

## Documentation/devicetree/bindings/pci/ucie-rcar-ep.yaml
```yaml
# SPDX-License-Identifier: (GPL-2.0-only OR BSD-2-Clause)
# Copyright (C) 2024 Renesas Electronics Corp.
%YAML 1.2
---
$id: http://devicetree.org/schemas/pci/rcar-gen4-pci-ep.yaml#
$schema: http://devicetree.org/meta-schemas/core.yaml#

title: Renesas R-Car UCIe Endpoint

maintainers:
	T.B.D

properties:
  compatible:
    items:
      - const: renesas,r8a78000-ucie-ep   # R-Car X5H

  reg:
    maxItems: 6

  reg-names:
    items:
      - const: dbi
      - const: dbi2
      - const: atu
      - const: dma
      - const: apb
      - const: addr_space

  interrupts:
    maxItems: 8

  interrupt-names:
    items:
      - const: others
      - const: dma
      - const: vndmsg
      - const: lperr
      - const: misc
      - const: coerr
      - const: fatal
      - const: nonfatal

  power-domains:
    maxItems: 1

  resets:
    maxItems: 1

  clocks:
    maxItems: 1

required:
  - compatible
  - reg
  - reg-names
  - interrupts
  - interrupts-names

unevaluatedProperties: false

examples:
	T.B.D
```

## Documentation/devicetree/bindings/pci/ucie-rcar-host.yaml
```yaml
# SPDX-License-Identifier: (GPL-2.0-only OR BSD-2-Clause)
# Copyright (C) 2024 Renesas Electronics Corp.
%YAML 1.2
---
$id: http://devicetree.org/schemas/pci/rcar-gen4-pci-host.yaml#
$schema: http://devicetree.org/meta-schemas/core.yaml#

title: Renesas R-Car UCIe Host

maintainers:
  - T.B.D

properties:
  compatible:
    items:
      - const: renesas,r8a78000-ucie   # R-Car X5H

  reg:
    maxItems: 4

  reg-names:
    items:
      - const: dbi
      - const: apb
      - const: atu
      - const: config

  interrupts:
    maxItems: 8

  interrupt-names:
    items:
      - const: others
      - const: dma
      - const: vndmsg
      - const: lperr
      - const: misc
      - const: coerr
      - const: fatal
      - const: nonfatal

  clocks:
    maxItems: 1

  power-domains:
    maxItems: 1

  resets:
    maxItems: 1

required:
  - compatible
  - reg
  - reg-names
  - interrupts
  - interrupts-names

unevaluatedProperties: false

examples:
	T.B.D
```

## Documentation/devicetree/bindings/phy/rcar-gen3-phy-usb2-clksel.txt
```
* Renesas R-Car generation 3 USB 2.0 clock selector PHY

This file provides information on what the device node for the R-Car generation
3 USB 2.0 clock selector PHY contains.

If you connect an external clock to the USB_EXTAL pin, you can use the
"renesas,usb_extal_only" property for it.
If you connect an oscillator to both the USB_XTAL and USB_EXTAL, this module
is not needed because this is default setting.

Case 1: An external clock connects to R-Car SoC
	+----------+   +--- R-Car ---------------------+
	|External  |---|USB_EXTAL ---> all usb channels|
	|clock     |   |USB_XTAL                       |
	+----------+   +-------------------------------+
In this case, we need this driver with "usb-extal-only" property.

Case 2: An oscillator connects to R-Car SoC
	+----------+   +--- R-Car ---------------------+
	|Oscillator|---|USB_EXTAL -+-> all usb channels|
	|          |---|USB_XTAL --+                   |
	+----------+   +-------------------------------+
In this case, we don't need this selector.

Required properties:
- compatible: "renesas,usb2-clksel-phy-r8a7795" if the device is a part of an
	      R8A7795 SoC.
	      "renesas,usb2-clksel-phy-r8a7796" if the device is a part of an
	      R8A7796 SoC.
	      "renesas,rcar-gen3-usb2-clksel-phy" for a generic R-Car Gen3
	      compatible device.

	      When compatible with the generic version, nodes must list the
	      SoC-specific version corresponding to the platform first
	      followed by the generic version.

- reg: offset and length of the USB 2.0 clock selector register block.
- clocks: clock phandle and specifier pair(s).
- #phy-cells: see phy-bindings.txt in the same directory, must be <0>.

Optional properties:
- renesas,usb-extal-only: to connect a clock generator to USB_EXTAL pin.

Example (R-Car H3):

	usb2_clksel_phy: usb-phy@e6590630 {
		compatible = "renesas,usb2-clksel-phy-r8a7795",
			     "renesas,rcar-gen3-usb2-clksel-phy";
		reg = <0 0xe6590630 0 0x02>;
		clocks = <&cpg CPG_MOD 703>;
		renesas,usb-extal-only;
	};

	&ehci0 {
		/* We should set usb2_clksel_phy into the first phys prop */
		phys = <&usb2_clksel_phy>, <&usb2_phy0>;
		phy-names = "usb_clk", "usb";

		status = "okay";
	};
```

## Documentation/devicetree/bindings/phy/rcar-gen3-phy-usb2.txt
```
* Renesas R-Car generation 3 USB 2.0 PHY

This file provides information on what the device node for the R-Car generation
3 USB 2.0 PHY contains.

Required properties:
- compatible: "renesas,usb2-phy-r8a7795" if the device is a part of R8A7795 SoC.
- reg: offset and length of the USB2.0 host register block.
- reg-names: must be "usb2".
- clocks: clock phandle and specifier pair.
- clock-names: string, clock input name, must be "usb2", and optional "hsusb".
- #phy-cells: see phy-bindings.txt in the same directory, must be <0>.

Optional proparies:
To use a USB channel which EHCI/OHCI and HSUSB are combined, the device tree
node should set HSUSB proparies to reg and reg-names proparies:
- reg: offset and length of the HSUSB register block.
- reg-names: must be "hsusb".

Example (R-Car H3):

	usb-phy@ee080200 {
		compatible = "renesas,usb2-phy-r8a7795";
		reg = <0 0xee080200 0 0x6ff>, <0 0xe6590100 0 0x100>;
		reg-names = "usb2", "hsusb";
		clocks = <&mstp7_clks R8A7795_CLK_EHCI0>,
			 <&mstp7_clks R8A7795_CLK_HSUSB>;
		clock-names = "usb2", "hsusb";
	};

	usb-phy@ee0a0200 {
		compatible = "renesas,usb2-phy-r8a7795";
		reg = <0 0xee0a0200 0 0x6ff>;
		reg-names = "usb2";
		clocks = <&mstp7_clks R8A7795_CLK_EHCI0>;
		clock-names = "usb2";
	};
```
