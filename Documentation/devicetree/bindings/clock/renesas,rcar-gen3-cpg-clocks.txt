## Documentation/devicetree/bindings/mmc/renesas,mmcif.txt
```
* Renesas Multi Media Card Interface (MMCIF) Controller

This file documents differences between the core properties in mmc.txt
and the properties used by the MMCIF device.


Required properties:

- compatible: should be "renesas,mmcif-<soctype>", "renesas,sh-mmcif" as a
  fallback. Examples with <soctype> are:
	- "renesas,mmcif-r7s72100" for the MMCIF found in r7s72100 SoCs
	- "renesas,mmcif-r8a73a4" for the MMCIF found in r8a73a4 SoCs
	- "renesas,mmcif-r8a7740" for the MMCIF found in r8a7740 SoCs
	- "renesas,mmcif-r8a7743" for the MMCIF found in r8a7743 SoCs
	- "renesas,mmcif-r8a7745" for the MMCIF found in r8a7745 SoCs
	- "renesas,mmcif-r8a7778" for the MMCIF found in r8a7778 SoCs
	- "renesas,mmcif-r8a7790" for the MMCIF found in r8a7790 SoCs
	- "renesas,mmcif-r8a7791" for the MMCIF found in r8a7791 SoCs
	- "renesas,mmcif-r8a7793" for the MMCIF found in r8a7793 SoCs
	- "renesas,mmcif-r8a7794" for the MMCIF found in r8a7794 SoCs
	- "renesas,mmcif-sh73a0" for the MMCIF found in sh73a0 SoCs

- interrupts: Some SoCs have only 1 shared interrupt, while others have either
  2 or 3 individual interrupts (error, int, card detect). Below is the number
  of interrupts for each SoC:
    1: r8a73a4, r8a7743, r8a7745, r8a7778, r8a7790, r8a7791, r8a7793, r8a7794
    2: r8a7740, sh73a0
    3: r7s72100

- clocks: reference to the functional clock

- dmas: reference to the DMA channels, one per channel name listed in the
  dma-names property.
- dma-names: must contain "tx" for the transmit DMA channel and "rx" for the
  receive DMA channel.
- max-frequency: Maximum operating clock frequency, driver uses default clock
  frequency if it is not set.

- hs400_auto_calib: Force auto calibration mode.
- adjust_hs400_offset: use the user-defined manual calibration offset.
- adjust_hs400_calibrate: use the user-defined manual calibration table.


Example: R8A7790 (R-Car H2) MMCIF0

	mmcif0: mmc@ee200000 {
		compatible = "renesas,mmcif-r8a7790", "renesas,sh-mmcif";
		reg = <0 0xee200000 0 0x80>;
		interrupts = <0 169 IRQ_TYPE_LEVEL_HIGH>;
		clocks = <&mstp3_clks R8A7790_CLK_MMCIF0>;
		dmas = <&dmac0 0xd1>, <&dmac0 0xd2>;
		dma-names = "tx", "rx";
		max-frequency = <97500000>;
	};

Example: R8A7795 (R-Car H3) SDHI2

	&sdhi2 {
		/* used for on-board 8bit eMMC */
		pinctrl-0 = <&sdhi2_pins>;
		pinctrl-1 = <&sdhi2_pins_uhs>;
		pinctrl-names = "default", "state_uhs";
		iommus = <&ipmmu_ds1 34>;
		vmmc-supply = <&reg_3p3v>;
		vqmmc-supply = <&reg_1p8v>;
		bus-width = <8>;
		mmc-hs200-1_8v;
		mmc-hs400-1_8v;
		adjust_hs400_offset = <3>;
		adjust_hs400_calibrate = <0  1  2  3  4  5  6  7  8  9
					  10 11 12 13 14 15 16 17 18 19
					  20 21 22 23 24 25 26 27 28 29
					  30 31>;
		non-removable;
		fixed-emmc-driver-type = <1>;
		status = "okay";
	};
```

## Documentation/devicetree/bindings/net/can/renesas,rcar-canxl.yaml
```yaml
# SPDX-License-Identifier: (GPL-2.0-only OR BSD-2-Clause)
%YAML 1.2
---
$id: http://devicetree.org/schemas/net/can/renesas,rcar-canxl.yaml#
$schema: http://devicetree.org/meta-schemas/core.yaml#

title: Renesas R-Car CAN XL Controller

maintainers:
  - Duy Nguyen <duy.nguyen.rh@renesas.com>

allOf:
  - $ref: can-controller.yaml#

properties:
  compatible:
    oneOf:
      - items:
          - enum:
              - renesas,r8a78000-canxl     # X5H
          - const: renesas,rcar-gen5-canxl # R-Car Gen5

  reg:
    maxItems: 1

  interrupts: true

  clocks:
    maxItems: 3

  clock-names:
    items:
      - const: fck
      - const: canxl
      - const: can_clk

  power-domains:
    maxItems: 1

  resets: true

  renesas,can-fd-frame:
    description:
      The controller can operate in either CAN XL mode (default) or
      CAN FD mode. Specify this property to put the controller in CAN FD mode.

  assigned-clocks:
    description:
      Reference to the CANXL clock.  The CANXL clock can be used by both CAN XL
      and CAN FD controllers at the same time.
      It needs to be scaled to maximum frequency if any of these controllers
      use it.

  assigned-clock-rates:
    description: Maximum frequency of the CANXL clock.

required:
  - compatible
  - reg
  - interrupts
  - interrupt-names
  - clocks
  - clock-names
  - power-domains
  - resets
  - assigned-clocks
  - assigned-clock-rates

properties:
  interrupts:
    items:
      - description: Function interrupt
      - description: Error interrupt

  interrupt-names:
    items:
      - const: func
      - const: err

  resets:
    maxItems: 1

unevaluatedProperties: false

examples:
  - |
    #include <dt-bindings/clock/r8a78000-cpg-mssr.h>
    #include <dt-bindings/interrupt-controller/arm-gic.h>
    #include <dt-bindings/power/r8a78000-sysc.h>

    canxl0: can@c1200000 {
             compatible = "renesas,r8a78000-canxl",
                          "renesas,rcar-gen5-canxl";
             reg = <0 0xc1200000 0 0x20104>;
             interrupts = <0 736 4>,
                          <0 737 4>;
             clocks = <&dummy_clk>,
                      <&canxl_clk>,
                      <&can_clk>;
             clock-names = "fck", "canxl", "can_clk";
             assigned-clocks = <&canxl_clk>;
             assigned-clock-rates = <160000000>;
             power-domains = <&sysc 64>;
             resets = <&cpg 328>;
             channel0;
             status = "okay";
    };
```

## Documentation/devicetree/bindings/net/renesas,ethertsn.yaml
```yaml
# SPDX-License-Identifier: (GPL-2.0-only OR BSD-2-Clause)
%YAML 1.2
---
$id: http://devicetree.org/schemas/net/renesas,ethertsn.yaml#
$schema: http://devicetree.org/meta-schemas/core.yaml#

title: Renesas Ethernet TSN

maintainers:
  - T.B.D

properties:
  compatible:
    oneOf:
      - items:
          - enum:
             - renesas,ethertsn-r8a779g0      # R-Car V4H

  reg: true

  interrupts: true

  interrupt-names: true

  clocks:
    maxItems: 1

  resets:
    maxItems: 1

  phy-mode: true

  phy-handle: true

  '#address-cells':
    description: Number of address cells for the MDIO bus.
    const: 1

  '#size-cells':
    description: Number of size cells on the MDIO bus.
    const: 0

patternProperties:
  "^ethernet-phy@[0-9a-f]$":
    type: object
    $ref: ethernet-phy.yaml#

required:
  - compatible
  - reg
  - interrupts
  - clocks
  - power-domains
  - resets
  - phy-mode
  - phy-handle
  - '#address-cells'
  - '#size-cells'

additionalProperties: false

examples:
  - |
    #include <dt-bindings/clock/r8a779g0-cpg-mssr.h>
    #include <dt-bindings/interrupt-controller/arm-gic.h>
    #include <dt-bindings/power/r8a779g0-sysc.h>
    #include <dt-bindings/gpio/gpio.h>

	rtsn0: ethernet@e6460000 {
		compatible = "renesas,ethertsn-r8a779g0";
		reg = <0 0xe6460000 0 0x4000>;
		interrupts = <GIC_SPI 429 IRQ_TYPE_LEVEL_HIGH>,
			     <GIC_SPI 430 IRQ_TYPE_LEVEL_HIGH>;
		interrupt-names = "tx_data", "rx_data";
		clocks = <&cpg CPG_MOD 2723>;
		power-domains = <&sysc R8A779G0_PD_ALWAYS_ON>;
		resets = <&cpg 2723>;
		phy-mode = "rgmii";
		phy-handle = <&phy3>;
		#address-cells = <1>;
		#size-cells = <0>;
	};

	phy3: ethernet-phy@3 {
		rxc-skew-ps = <1500>;
		reg = <0>;
		interrupt-parent = <&gpio4>;
		interrupts = <3 IRQ_TYPE_LEVEL_LOW>;
		reset-gpios = <&gpio1 23 GPIO_ACTIVE_LOW>;
	};
```

## Documentation/devicetree/bindings/pci/rcar-gen4-pci-ep.yaml
```yaml
# SPDX-License-Identifier: (GPL-2.0-only OR BSD-2-Clause)
# Copyright (C) 2022 Renesas Electronics Corp.
%YAML 1.2
---
$id: http://devicetree.org/schemas/pci/rcar-gen4-pci-ep.yaml#
$schema: http://devicetree.org/meta-schemas/core.yaml#

title: Renesas R-Car Gen4 PCIe Endpoint

maintainers:
  - Yoshihiro Shimoda <yoshihiro.shimoda.uh@renesas.com>

allOf:
  - $ref: snps,dw-pcie-ep.yaml#

properties:
  compatible:
    items:
      - const: renesas,r8a779f0-pcie-ep   # R-Car S4-8
      - const: renesas,rcar-gen4-pcie-ep  # R-Car Gen4

  reg:
    maxItems: 4

  reg-names:
    items:
      - const: dbi
      - const: atu
      - const: appl
      - const: addr_space

  interrupts:
    maxItems: 3

  interrupt-names:
    items:
      - const: dma
      - const: sft_ce
      - const: app

  power-domains:
    maxItems: 1

  resets:
    maxItems: 1

  clocks:
    maxItems: 1

  max-link-speed: true

  num-lanes: true

required:
  - compatible
  - reg
  - reg-names
  - interrupts
  - resets
  - power-domains
  - clocks

additionalProperties: false

examples:
  - |
    #include <dt-bindings/clock/r8a779f0-cpg-mssr.h>
    #include <dt-bindings/interrupt-controller/arm-gic.h>
    #include <dt-bindings/power/r8a779f0-sysc.h>

    soc {
        #address-cells = <2>;
        #size-cells = <2>;

        pcie0_ep: pcie-ep@e65d0000 {
            compatible = "renesas,r8a779f0-pcie-ep", "renesas,rcar-gen4-pcie-ep";
            reg = <0 0xe65d0000 0 0x1000>, <0 0xe65d1000 0 0x1000>,
                  <0 0xe65d3000 0 0x2000>, <0 0xfe000000 0 0x400000>;
            reg-names = "dbi", "atu", "appl", "addr_space";
            interrupts = <GIC_SPI 417 IRQ_TYPE_LEVEL_HIGH>,
                         <GIC_SPI 418 IRQ_TYPE_LEVEL_HIGH>,
                         <GIC_SPI 422 IRQ_TYPE_LEVEL_HIGH>;
            interrupt-names = "dma", "sft_ce", "app";
            clocks = <&cpg CPG_MOD 624>;
            power-domains = <&sysc R8A779F0_PD_ALWAYS_ON>;
            resets = <&cpg 624>;
            num-lanes = <2>;
            max-link-speed = <2>;
        };
    };
```

## Documentation/devicetree/bindings/pci/rcar-gen4-pci-host.yaml
```yaml
# SPDX-License-Identifier: (GPL-2.0-only OR BSD-2-Clause)
# Copyright (C) 2022 Renesas Electronics Corp.
%YAML 1.2
---
$id: http://devicetree.org/schemas/pci/rcar-gen4-pci-host.yaml#
$schema: http://devicetree.org/meta-schemas/core.yaml#

title: Renesas R-Car Gen4 PCIe Host

maintainers:
  - Yoshihiro Shimoda <yoshihiro.shimoda.uh@renesas.com>

allOf:
  - $ref: snps,dw-pcie.yaml#

properties:
  compatible:
    items:
      - const: renesas,r8a779f0-pcie   # R-Car S4-8
      - const: renesas,rcar-gen4-pcie  # R-Car Gen4

  interrupts:
    maxItems: 4

  interrupt-names:
    items:
      - const: msi
      - const: dma
      - const: sft_ce
      - const: app

  clocks:
    maxItems: 1

  power-domains:
    maxItems: 1

  resets:
    maxItems: 1

required:
  - compatible
  - reg
  - interrupts
  - clocks
  - power-domains

unevaluatedProperties: false

examples:
  - |
    #include <dt-bindings/clock/r8a779f0-cpg-mssr.h>
    #include <dt-bindings/interrupt-controller/arm-gic.h>
    #include <dt-bindings/power/r8a779f0-sysc.h>

    soc {
        #address-cells = <2>;
        #size-cells = <2>;

        pcie: pcie@e65d0000 {
            compatible = "renesas,r8a779f0-pcie", "renesas,rcar-gen4-pcie";
            reg = <0 0xe65d0000 0 0x3000>, <0 0xe65d3000 0 0x2000>,
                  <0 0xe65d6200 0 0x0e00>, <0 0xfe000000 0 0x400000>;
            reg-names = "dbi", "atu", "app", "config";
            #address-cells = <3>;
            #size-cells = <2>;
            bus-range = <0x00 0xff>;
            device_type = "pci";
            ranges =  <0x81000000 0 0x00000000 0 0xfe000000 0 0x00010000
                       0x82000000 0 0x30000000 0 0x30000000 0 0x10000000>;
            dma-ranges = <0x42000000 0 0x40000000 0 0x40000000 0 0x80000000>;
            interrupts = <GIC_SPI 416 IRQ_TYPE_LEVEL_HIGH>,
                         <GIC_SPI 417 IRQ_TYPE_LEVEL_HIGH>,
                         <GIC_SPI 418 IRQ_TYPE_LEVEL_HIGH>,
                         <GIC_SPI 422 IRQ_TYPE_LEVEL_HIGH>;
            interrupt-names = "msi", "dma", "sft_ce", "app";
            #interrupt-cells = <1>;
            interrupt-map-mask = <0 0 0 7>;
            interrupt-map = <0 0 0 1 &gic GIC_SPI 416 IRQ_TYPE_LEVEL_HIGH
                             0 0 0 2 &gic GIC_SPI 416 IRQ_TYPE_LEVEL_HIGH
                             0 0 0 3 &gic GIC_SPI 416 IRQ_TYPE_LEVEL_HIGH
                             0 0 0 4 &gic GIC_SPI 416 IRQ_TYPE_LEVEL_HIGH>;
            clocks = <&cpg CPG_MOD 624>;
            power-domains = <&sysc R8A779F0_PD_ALWAYS_ON>;
            resets = <&cpg 624>;
            num-lanes = <2>;
            snps,enable-cdm-check;
            max-link-speed = <2>;
        };
    };
```

## Documentation/devicetree/bindings/pci/rcar-gen5-pcie-host.yaml
```yaml
# SPDX-License-Identifier: (GPL-2.0-only OR BSD-2-Clause)
# Copyright (C) 2022 Renesas Electronics Corp.
%YAML 1.2
---
$id: http://devicetree.org/schemas/pci/rcar-gen4-pci-host.yaml#
$schema: http://devicetree.org/meta-schemas/core.yaml#

title: Renesas R-Car Gen5 PCIe 4.0 Host

maintainers:
  - Tin Tran <tin.tran.xk@renesas.com>

allOf:
  - $ref: snps,dw-pcie.yaml#

properties:
  compatible:
    items:
      - const: renesas,rcar-gen5-pcie  # R-Car Gen5

  interrupts:
    maxItems: 7

  clocks:
    maxItems: 1

  power-domains:
    maxItems: 1

  resets:
    maxItems: 1

required:
  - compatible
  - reg
  - interrupts
  - clocks
  - power-domains

unevaluatedProperties: false

examples:

        pciec0: pcie@C9C8E000 {
		compatible = "renesas,rcar-gen5-pcie";
		reg = <0 0xC9C8E000 0 0x3000>,
		      <0 0xC9C91000 0 0x2000>,
		      <0 0xC9C93000 0 0x1200>,
		      <0 0xC9C94200 0 0x0e00>,
		      <0 0xC9C95000 0 0x1000>,
		      <0 0xC9000000 0 0x100000>;
		reg-names = "dbi",
			    "atu",
			    "dma",
			    "app",
			    "phy",
			    "config";
		#address-cells = <3>;
		#size-cells = <2>;
		bus-range = <0x00 0xff>;
		device_type = "pci";
		ranges =  <0x03000000 0x1 0x0000000 0x1 0x00000000 0 0x20000000>;
		interrupts = <0 360 4>,
			     <0 361 4>,
			     <0 370 4>,
			     <0 370 4>,
			     <0 370 4>,
			     <0 363 4>,
			     <0 362 4>;
		#interrupt-cells = <1>;
		interrupt-map-mask = <0 0 0 7>;
		interrupt-map = <0 0 0 1 &gic 0 0x38000000 0 360 4
				 0 0 0 2 &gic 0 0x38000000 0 361 4
				 0 0 0 3 &gic 0 0x38000000 0 370 4
				 0 0 0 4 &gic 0 0x38000000 0 370 4
				 0 0 0 4 &gic 0 0x38000000 0 370 4
				 0 0 0 4 &gic 0 0x38000000 0 363 4
				 0 0 0 4 &gic 0 0x38000000 0 362 4>;
		clocks = <&pcie_bus_clk>;
		clock-names = "pcie_bus";
		num-lanes = <2>;
		max-link-speed = <4>;
		status = "okay";
	};
```

## Documentation/devicetree/bindings/pci/rcar-gen5-pcie6-ep.yaml
```yaml
# SPDX-License-Identifier: (GPL-2.0-only OR BSD-2-Clause)
# Copyright (C) 2022 Renesas Electronics Corp.
%YAML 1.2
---
$id: http://devicetree.org/schemas/pci/rcar-gen4-pci-host.yaml#
$schema: http://devicetree.org/meta-schemas/core.yaml#

title: Renesas R-Car Gen5 PCIe 6.0 Endpoint

maintainers:
  - Tin Tran <tin.tran.xk@renesas.com>

allOf:
  - $ref: snps,dw-pcie-ep.yaml#

properties:
  compatible:
    items:
      - const: renesas,rcar-gen5-pcie6-ep # R-Car Gen5

  interrupts:
    maxItems: 9

  clocks:
    maxItems: 1

  power-domains:
    maxItems: 1

  resets:
    maxItems: 1

required:
  - compatible
  - reg
  - interrupts
  - clocks
  - power-domains

unevaluatedProperties: false

examples:

        pcie6_ep: pcie6-ep@0xDE000000 {
                compatible = "renesas,rcar-gen5-pcie6-ep";
                reg = <0 0xDE000000 0 0x70000>, <0 0xDE100000 0 0x200000>,
                      <0 0xDE300000 0 0x80000>,<0 0xDE380000 0 0x1200>,
                      <0x0 0xDB000000 0x0 0x400000>;
                reg-names = "dbi", "dbi2",
                            "atu", "dma",
                            "addr_space";
                interrupts = <0 348 4>,
                             <0 349 4>,
                             <0 350 4>,
                             <0 354 4>,
                             <0 355 4>,
                             <0 355 4>,
                             <0 355 4>,
                             <0 355 4>,
                             <0 356 4>;
                clocks = <&pcie_bus>;
                clock-names = "pcie_bus";
                num-lanes = <2>;
                num-ib-windows = <16>;
                num-ob-windows = <16>;
                status = "okay";
};
```
