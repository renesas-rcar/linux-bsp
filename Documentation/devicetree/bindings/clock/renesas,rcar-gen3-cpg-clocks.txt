## Documentation/devicetree/bindings/clock/renesas,rcar-gen3-cpg-clocks.txt
```
* Renesas R-Car Gen3 Clock Pulse Generator (CPG)

The CPG generates core clocks for the R-Car Gen3 SoCs. It includes three PLLs
and several fixed ratio dividers.
The CPG also provides a Clock Domain for SoC devices, in combination with the
CPG Module Stop (MSTP) Clocks.

Required Properties:

  - compatible: Must be one of
    - "renesas,r8a7795-cpg-clocks" for the r8a7795 CPG
    - "renesas,rcar-gen3-cpg-clocks" for the generic R-Car Gen3 CPG

  - reg: Base address and length of the memory resource used by the CPG

  - clocks: References to the parent clocks: first to the EXTAL clock
  - #clock-cells: Must be 1
  - clock-output-names: The names of the clocks. Supported clocks are
    "main", "pll0", "pll1", "pll2", "pll3", "pll4"
  - #power-domain-cells: Must be 0

SoC devices that are part of the CPG/MSTP Clock Domain and can be power-managed
through an MSTP clock should refer to the CPG device node in their
"power-domains" property, as documented by the generic PM domain bindings in
Documentation/devicetree/bindings/power/power_domain.txt.

Examples
--------

  - CPG device node:

	cpg_clocks: cpg_clocks@e6150000 {
		compatible = "renesas,r8a7795-cpg-clocks",
			     "renesas,rcar-gen3-cpg-clocks";
		reg = <0 0xe6150000 0 0x1000>;
		clocks = <&extal_clk>;
		#clock-cells = <1>;
		clock-output-names = "main", "pll0", "pll1","pll2",
				     "pll3", "pll4";
		#power-domain-cells = <0>;
	};

  - CPG/MSTP Clock Domain member device node:

	scif2: serial@e6e88000 {
		compatible = "renesas,scif-r8a7795", "renesas,scif";
		reg = <0 0xe6e88000 0 64>;
		interrupts = <GIC_SPI 164 IRQ_TYPE_LEVEL_HIGH>;
		clocks = <&mstp3_clks RCAR_R8A7795_CLK_SCIF2>;
		clock-names = "sci_ick";
		power-domains = <&cpg_clocks>;
	};
```

## Documentation/devicetree/bindings/cpufreq/avs/rcar-avs.txt
```
R-Car AVS driver

It is a simple driver that checks AVS (Adaptive Voltage Scaling) value of
chip. It helps to AVS user device select the best opp table (appropriate table with
avs value) to apply for the chip at runtime.

Required properties:
 - reg: address and offset for registers of AVS.
 - target_devices: all target devices (e.g. cpu, gpu...) that will apply avs value.
    Note: when adding cpu nodes, it needs to list all
    cpu nodes that are on same cluster together.

Optional properties:
 - None

Examples:
 - Below is device tree definition for R-Car H3/M3:

  For R-Car H3 ES2.0+:
	avs: avs@e60a013c {
		compatible = "renesas,r8a77951-avs", "renesas,rcar-gen3-avs";
		reg = <0 0xe60a013c 0 0x04>;
		target_devices = <&a57_0>, <&a57_1>, <&a57_2>, <&a57_3>;
	};

  For R-Car M3 ES1.x:
	avs: avs@e60a013c {
		compatible = "renesas,r8a77960-avs", "renesas,rcar-gen3-avs";
		reg = <0 0xe60a013c 0 0x04>;
		target_devices = <&a57_0>, <&a57_1>;
	};

  For R-Car M3 ES3.0:
        avs: avs@e60a013c {
                compatible = "renesas,r8a77961-avs", "renesas,rcar-gen3-avs";
                reg = <0 0xe60a013c 0 0x04>;
                target_devices = <&a57_0>, <&a57_1>;
        };

- Below is device tree definition for R-Car V4H:
	avs: avs@e60a0080 {
		compatible = "renesas,r8a779g0-avs", "renesas,rcar-gen4-avs";
		reg = <0 0xe60a0080 0 0x04>;
		clocks = <&cpg CPG_MOD 123>;
		resets = <&cpg 123>;
		target_devices = <&a76_0>, <&a76_1>, <&a76_2>, <&a76_3>;
	};
```

## Documentation/devicetree/bindings/display/panel/panel-lvds.txt
```
Generic LVDS Panel
==================

LVDS is a physical layer specification defined in ANSI/TIA/EIA-644-A. Multiple
incompatible data link layers have been used over time to transmit image data
to LVDS panels. This bindings supports display panels compatible with the
following specifications.

[JEIDA] "Digital Interface Standards for Monitor", JEIDA-59-1999, February
1999 (Version 1.0), Japan Electronic Industry Development Association (JEIDA)
[LDI] "Open LVDS Display Interface", May 1999 (Version 0.95), National
Semiconductor
[VESA] "VESA Notebook Panel Standard", October 2007 (Version 1.0), Video
Electronics Standards Association (VESA)

Device compatible with those specifications have been marketed under the
FPD-Link and FlatLink brands.


Required properties:
- compatible: shall contain "panel-lvds"
- width-mm: panel display width in millimeters
- height-mm: panel display height in millimeters
- data-mapping: the color signals mapping order, "jeida-18", "jeida-24"
  or "vesa-24"

Optional properties:
- label: a symbolic name for the panel
- avdd-supply: reference to the regulator that powers the panel analog supply
- dvdd-supply: reference to the regulator that powers the panel digital supply
- data-mirror: if set, reverse the bit order on all data lanes (6 to 0 instead
  of 0 to 6)

Required nodes:
- One "panel-timing" node containing video timings, in accordance with the
  display timing bindings defined in
  Documentation/devicetree/bindings/display/display-timing.txt.
- One "port" child node for the LVDS input port, in accordance with the
  video interface bindings defined in
  Documentation/devicetree/bindings/media/video-interfaces.txt.


LVDS data mappings are defined as follows.

- "jeida-18" - 18-bit data mapping compatible with the [JEIDA], [LDI] and
  [VESA] specifications. Data are transferred as follows on 3 LVDS lanes.

Slot	    0       1       2       3       4       5       6
	________________                         _________________
Clock	                \_______________________/
	  ______  ______  ______  ______  ______  ______  ______
DATA0	><__G0__><__R5__><__R4__><__R3__><__R2__><__R1__><__R0__><
DATA1	><__B1__><__B0__><__G5__><__G4__><__G3__><__G2__><__G1__><
DATA2	><_CTL2_><_CTL1_><_CTL0_><__B5__><__B4__><__B3__><__B2__><

- "jeida-24" - 24-bit data mapping compatible with the [DSIM] and [LDI]
  specifications. Data are transferred as follows on 4 LVDS lanes.

Slot	    0       1       2       3       4       5       6
	________________                         _________________
Clock	                \_______________________/
	  ______  ______  ______  ______  ______  ______  ______
DATA0	><__G2__><__R7__><__R6__><__R5__><__R4__><__R3__><__R2__><
DATA1	><__B3__><__B2__><__G7__><__G6__><__G5__><__G4__><__G3__><
DATA2	><_CTL2_><_CTL1_><_CTL0_><__B7__><__B6__><__B5__><__B4__><
DATA3	><_CTL3_><__B1__><__B0__><__G1__><__G0__><__R1__><__R0__><

- "vesa-24" - 24-bit data mapping compatible with the [VESA] specification.
  Data are transferred as follows on 4 LVDS lanes.

Slot	    0       1       2       3       4       5       6
	________________                         _________________
Clock	                \_______________________/
	  ______  ______  ______  ______  ______  ______  ______
DATA0	><__G0__><__R5__><__R4__><__R3__><__R2__><__R1__><__R0__><
DATA1	><__B1__><__B0__><__G5__><__G4__><__G3__><__G2__><__G1__><
DATA2	><_CTL2_><_CTL1_><_CTL0_><__B5__><__B4__><__B3__><__B2__><
DATA3	><_CTL3_><__B7__><__B6__><__G7__><__G6__><__R7__><__R6__><


Control signals are mapped as follows.

CTL0: HSync
CTL1: VSync
CTL2: Data Enable
CTL3: 0


Example
-------

panel {
	compatible = "mitsubishi,aa121td01", "panel-lvds";
	label = "lcd";

	width-mm = <261>;
	height-mm = <163>;

	data-mapping = "jeida-24";

	panel-timing {
		/* 1280x800 @60Hz */
		clock-frequency = <71000000>;
		hactive = <1280>;
		vactive = <800>;
		hsync-len = <70>;
		hfront-porch = <20>;
		hback-porch = <70>;
		vsync-len = <5>;
		vfront-porch = <3>;
		vback-porch = <15>;
	};

	port {
		panel_in: endpoint {
			remote-endpoint = <&lvds_connector>;
		};
	};
};
```

## Documentation/devicetree/bindings/dma/renesas,rcar-dmac.txt
```
* Renesas R-Car (RZ/G) DMA Controller Device Tree bindings

Renesas R-Car (Gen 2/3) and RZ/G SoCs have multiple multi-channel DMA
controller instances named DMAC capable of serving multiple clients. Channels
can be dedicated to specific clients or shared between a large number of
clients.

Each DMA client is connected to one dedicated port of the DMAC, identified by
an 8-bit port number called the MID/RID. A DMA controller can thus serve up to
256 clients in total. When the number of hardware channels is lower than the
number of clients to be served, channels must be shared between multiple DMA
clients. The association of DMA clients to DMAC channels is fully dynamic and
not described in these device tree bindings.

Required Properties:

- compatible: "renesas,dmac-<soctype>", "renesas,rcar-dmac" as fallback.
	      "renesas,rcar-v3u-dmac" as fallback for R-Car V3U.
	      "renesas,rcar-v3u-rt-dmac" as fallback for RT-DMAC of R-Car V3U.

	      Examples with soctypes are:
		- "renesas,dmac-r8a7743" (RZ/G1M)
		- "renesas,dmac-r8a7744" (RZ/G1N)
		- "renesas,dmac-r8a7745" (RZ/G1E)
		- "renesas,dmac-r8a77470" (RZ/G1C)
		- "renesas,dmac-r8a774a1" (RZ/G2M)
		- "renesas,dmac-r8a774c0" (RZ/G2E)
		- "renesas,dmac-r8a7790" (R-Car H2)
		- "renesas,dmac-r8a7791" (R-Car M2-W)
		- "renesas,dmac-r8a7792" (R-Car V2H)
		- "renesas,dmac-r8a7793" (R-Car M2-N)
		- "renesas,dmac-r8a7794" (R-Car E2)
		- "renesas,dmac-r8a7795" (R-Car H3)
		- "renesas,dmac-r8a7796" (R-Car M3-W)
		- "renesas,dmac-r8a77965" (R-Car M3-N)
		- "renesas,dmac-r8a77970" (R-Car V3M)
		- "renesas,dmac-r8a77980" (R-Car V3H)
		- "renesas,dmac-r8a77990" (R-Car E3)
		- "renesas,dmac-r8a77995" (R-Car D3)
		- "renesas,dmac-r8a779a0" (R-Car V3U)

- reg: base address and length of the registers block for the DMAC.
  For R-Car V3U (the memory map is not consecutive), the first base address
  and length of the registers block for DMAC base memory, and the second ones
  for DMAC channel memory.

- interrupts: interrupt specifiers for the DMAC, one for each entry in
  interrupt-names.
- interrupt-names: one entry for the error interrupt, named "error", plus one
  entry per channel, named "ch%u", where %u is the channel number ranging from
  zero to the number of channels minus one.

- clock-names: "fck" for the functional clock
- clocks: a list of phandle + clock-specifier pairs, one for each entry
  in clock-names.
- clock-names: must contain "fck" for the functional clock.

- #dma-cells: must be <1>, the cell specifies the MID/RID of the DMAC port
  connected to the DMA client
- dma-channels: number of DMA channels

Optional Properties:

- fixed-source: to enable fixed source address mode.
- fixed-dest: to enable fixed destination address mode.

- rate-read: read rate control (slow speed mode), only available on R-Car V3U
  the valid value is in [0x03, 0xff].
- rate-write: write rate control (slow speed mode), only available on R-Car V3U
  the valid value is in [0x03, 0xff].

Example: R8A7790 (R-Car H2) SYS-DMACs

	dmac0: dma-controller@e6700000 {
		compatible = "renesas,dmac-r8a7790", "renesas,rcar-dmac";
		reg = <0 0xe6700000 0 0x20000>;
		interrupts = <0 197 IRQ_TYPE_LEVEL_HIGH
			      0 200 IRQ_TYPE_LEVEL_HIGH
			      0 201 IRQ_TYPE_LEVEL_HIGH
			      0 202 IRQ_TYPE_LEVEL_HIGH
			      0 203 IRQ_TYPE_LEVEL_HIGH
			      0 204 IRQ_TYPE_LEVEL_HIGH
			      0 205 IRQ_TYPE_LEVEL_HIGH
			      0 206 IRQ_TYPE_LEVEL_HIGH
			      0 207 IRQ_TYPE_LEVEL_HIGH
			      0 208 IRQ_TYPE_LEVEL_HIGH
			      0 209 IRQ_TYPE_LEVEL_HIGH
			      0 210 IRQ_TYPE_LEVEL_HIGH
			      0 211 IRQ_TYPE_LEVEL_HIGH
			      0 212 IRQ_TYPE_LEVEL_HIGH
			      0 213 IRQ_TYPE_LEVEL_HIGH
			      0 214 IRQ_TYPE_LEVEL_HIGH>;
		interrupt-names = "error",
				"ch0", "ch1", "ch2", "ch3",
				"ch4", "ch5", "ch6", "ch7",
				"ch8", "ch9", "ch10", "ch11",
				"ch12", "ch13", "ch14";
		clocks = <&mstp2_clks R8A7790_CLK_SYS_DMAC0>;
		clock-names = "fck";
		#dma-cells = <1>;
		dma-channels = <15>;
	};

	dmac1: dma-controller@e6720000 {
		compatible = "renesas,dmac-r8a7790", "renesas,rcar-dmac";
		reg = <0 0xe6720000 0 0x20000>;
		interrupts = <0 220 IRQ_TYPE_LEVEL_HIGH
			      0 216 IRQ_TYPE_LEVEL_HIGH
			      0 217 IRQ_TYPE_LEVEL_HIGH
			      0 218 IRQ_TYPE_LEVEL_HIGH
			      0 219 IRQ_TYPE_LEVEL_HIGH
			      0 308 IRQ_TYPE_LEVEL_HIGH
			      0 309 IRQ_TYPE_LEVEL_HIGH
			      0 310 IRQ_TYPE_LEVEL_HIGH
			      0 311 IRQ_TYPE_LEVEL_HIGH
			      0 312 IRQ_TYPE_LEVEL_HIGH
			      0 313 IRQ_TYPE_LEVEL_HIGH
			      0 314 IRQ_TYPE_LEVEL_HIGH
			      0 315 IRQ_TYPE_LEVEL_HIGH
			      0 316 IRQ_TYPE_LEVEL_HIGH
			      0 317 IRQ_TYPE_LEVEL_HIGH
			      0 318 IRQ_TYPE_LEVEL_HIGH>;
		interrupt-names = "error",
				"ch0", "ch1", "ch2", "ch3",
				"ch4", "ch5", "ch6", "ch7",
				"ch8", "ch9", "ch10", "ch11",
				"ch12", "ch13", "ch14";
		clocks = <&mstp2_clks R8A7790_CLK_SYS_DMAC1>;
		clock-names = "fck";
		#dma-cells = <1>;
		dma-channels = <15>;
	};

Example: R8A779A0 (R-Car V3U) SYS-DMAC

	dmac1: dma-controller@e7350000 {
		compatible = "renesas,dmac-r8a779a0",
			     "renesas,rcar-v3u-dmac";
		reg = <0 0xe7350000 0 0x1000>,
		      <0 0xe7300000 0 0xf104>;
		interrupts = <0 6 IRQ_TYPE_LEVEL_HIGH
			      0 32 IRQ_TYPE_LEVEL_HIGH
			      0 33 IRQ_TYPE_LEVEL_HIGH
			      0 34 IRQ_TYPE_LEVEL_HIGH
			      0 35 IRQ_TYPE_LEVEL_HIGH
			      0 36 IRQ_TYPE_LEVEL_HIGH
			      0 37 IRQ_TYPE_LEVEL_HIGH
			      0 38 IRQ_TYPE_LEVEL_HIGH
			      0 39 IRQ_TYPE_LEVEL_HIGH
			      0 40 IRQ_TYPE_LEVEL_HIGH
			      0 41 IRQ_TYPE_LEVEL_HIGH
			      0 42 IRQ_TYPE_LEVEL_HIGH
			      0 43 IRQ_TYPE_LEVEL_HIGH
			      0 44 IRQ_TYPE_LEVEL_HIGH
			      0 45 IRQ_TYPE_LEVEL_HIGH
			      0 46 IRQ_TYPE_LEVEL_HIGH
			      0 47 IRQ_TYPE_LEVEL_HIGH>;
		interrupt-names = "error",
				"ch0", "ch1", "ch2", "ch3",
				"ch4", "ch5", "ch6", "ch7",
				"ch8", "ch9", "ch10", "ch11",
				"ch12", "ch13", "ch14", "ch15";
		clocks = <&cpg CPG_MOD 709>;
		clock-names = "fck";
		#dma-cells = <1>;
		dma-channels = <16>;
		fixed-source;
		fixed-dest;
		rate-read = <0x03>;
		rate-write = <0xff>;
	};

Example: R8A779A0 (R-Car V3U) RT-DMAC

	rt_dmac0: dma-controller@ffd60000 {
		compatible = "renesas,dmac-r8a779a0",
			     "renesas,rcar-v3u-rt-dmac";
		reg = <0 0xffd60000 0 0x1000>,
		      <0 0xffc10000 0 0xf104>;
		interrupts = <0 8 IRQ_TYPE_LEVEL_HIGH
			      0 64 IRQ_TYPE_LEVEL_HIGH
			      0 65 IRQ_TYPE_LEVEL_HIGH
			      0 66 IRQ_TYPE_LEVEL_HIGH
			      0 67 IRQ_TYPE_LEVEL_HIGH
			      0 68 IRQ_TYPE_LEVEL_HIGH
			      0 69 IRQ_TYPE_LEVEL_HIGH
			      0 70 IRQ_TYPE_LEVEL_HIGH
			      0 71 IRQ_TYPE_LEVEL_HIGH
			      0 72 IRQ_TYPE_LEVEL_HIGH
			      0 73 IRQ_TYPE_LEVEL_HIGH
			      0 74 IRQ_TYPE_LEVEL_HIGH
			      0 75 IRQ_TYPE_LEVEL_HIGH
			      0 76 IRQ_TYPE_LEVEL_HIGH
			      0 77 IRQ_TYPE_LEVEL_HIGH
			      0 78 IRQ_TYPE_LEVEL_HIGH
			      0 79 IRQ_TYPE_LEVEL_HIGH>;
		interrupt-names = "error",
				"ch0", "ch1", "ch2", "ch3",
				"ch4", "ch5", "ch6", "ch7",
				"ch8", "ch9", "ch10", "ch11",
				"ch12", "ch13", "ch14", "ch15";
		clocks = <&cpg CPG_MOD 630>;
		clock-names = "fck";
		#dma-cells = <1>;
		dma-channels = <16>;
	};
```

## Documentation/devicetree/bindings/hwlock/rcar-hwspinlock.txt
```
DT bindings for the Renesas R-Car Hardware spinlock driver
----------------------------------------------------------

Required properties :
- compatible : shall contain only one of the following:
	- "renesas,mfis-lock-r8a7795", "renesas,mfis-lock";
	- "renesas,mfis-lock-r8a7796", "renesas,mfis-lock";
	- "renesas,mfis-lock-r8a77965", "renesas,mfis-lock";

- reg : start address and length for MFIS registers.

- #hwlock-cells : should be 1. hwspinlock users specify the hwspinlock id
	to request a specific hwspinlock.

Please look at the generic hwlock binding for usage information for consumers,
"Documentation/devicetree/bindings/hwlock/hwlock.txt"

Examples:

mfis: mfis@e6260000 {
	compatible = "renesas,mfis-lock-r8a7795",
		     "renesas,mfis-lock";
	reg = <0 0xe6260000 0 0x1000>;
	#hwlock-cells = <1>;
};
```
