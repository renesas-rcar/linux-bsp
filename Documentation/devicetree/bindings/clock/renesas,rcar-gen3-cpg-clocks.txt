## Documentation/devicetree/bindings/i2c/i2c-rc21008a.yaml
```yaml
# SPDX-License-Identifier: (GPL-2.0-only OR BSD-2-Clause)
%YAML 1.2
---
$id: http://devicetree.org/schemas/i2c/i2c-rc21008a.yaml#
$schema: http://devicetree.org/meta-schemas/core.yaml#

title: Renesas RC21008A Clock Generator

maintainers:
  - Cong Dang <cong.dang.xn@renesas.com>

properties:
  compatible:
    enum:
      - renesas,rc21008a

  reg:
    maxItems: 1

required:
  - compatible
  - reg

additionalProperties: false

examples:
	clk_pcie: clk-controller@6c {
		compatible = "renesas,rc21008a";
		reg = <0x6c>;
	};
```

## Documentation/devicetree/bindings/media/i2c/adv7482.txt
```
* Analog Devices ADV7482 video decoder with HDMI receiver

The ADV7482 are a multi format video decoders with an integrated
HDMI receiver. It can output CSI-2 on two independent outputs
TXA and TXB from three input sources HDMI, analog and TTL.

Required Properties:

  - compatible: Must contain one of the following
    - "adi,adv7482" for the ADV7482

  - reg: I2C slave address

The device node must contain one 'port' child node per device input and output
port, in accordance with the video interface bindings defined in
Documentation/devicetree/bindings/media/video-interfaces.txt. The port nodes
are numbered as follows.

  Name                  Type            Port
------------------------------------------------------------
  HDMI                  sink            0
  AIN1                  sink            1
  AIN                   sink            2
  AIN                   sink            3
  AIN                   sink            4
  AIN                   sink            5
  AIN                   sink            6
  AIN                   sink            7
  AIN                   sink            8
  TTL                   sink            9
  TXA                   source          10
  TXB                   source          11

The digital output port node must contain at least one source endpoint.

Example:

    video_receiver@70 {
            compatible = "adi,adv7482";
            reg = <0x70>;

            #address-cells = <1>;
            #size-cells = <0>;

            port@10 {
                    reg = <10>;
                    adv7482_txa: endpoint@1 {
                            clock-lanes = <0>;
                            data-lanes = <1 2 3 4>;
                            remote-endpoint = <&csi40_in>;
                    };
            };

            port@11 {
                    reg = <11>;
                    adv7482_txb: endpoint@1 {
                            clock-lanes = <0>;
                            data-lanes = <1>;
                            remote-endpoint = <&csi20_in>;
                    };
            };
    };
```

## Documentation/devicetree/bindings/media/rcar-csi2.txt
```
Renesas R-Car MIPI CSI-2
------------------------

The rcar-csi2 device provides MIPI CSI-2 capabilities for the Renesas R-Car
family of devices. It is to be used in conjunction with the R-Car VIN module,
which provides the video capture capabilities.

 - compatible: Must be one or more of the following
   - "renesas,r8a7795-csi2" for the R8A7795 device.
   - "renesas,r8a7796-csi2" for the R8A7796 device.
   - "renesas,rcar-gen3-csi2" for a generic R-Car Gen3 compatible device.

   When compatible with a generic version nodes must list the
   SoC-specific version corresponding to the platform first
   followed by the generic version.

 - reg: the register base and size for the device registers
 - interrupts: the interrupt for the device
 - clocks: Reference to the parent clock

The device node should contain two 'port' child nodes according to the
bindings defined in Documentation/devicetree/bindings/media/
video-interfaces.txt. Port 0 should connect the node that is the video
source for to the CSI-2. Port 1 should connect all the R-Car VIN
modules, which can make use of the CSI-2 module.

- Port 0 - Video source
	- Reg 0 - sub-node describing the endpoint that is the video source

- Port 1 - VIN instances
	- Reg 0 - sub-node describing the endpoint that is VIN0
	- Reg 1 - sub-node describing the endpoint that is VIN1
	- Reg 2 - sub-node describing the endpoint that is VIN2
	- Reg 3 - sub-node describing the endpoint that is VIN3
	- Reg 4 - sub-node describing the endpoint that is VIN4
	- Reg 5 - sub-node describing the endpoint that is VIN5
	- Reg 6 - sub-node describing the endpoint that is VIN6
	- Reg 7 - sub-node describing the endpoint that is VIN7

Example:

/* SoC properties */

	 csi20: csi2@fea80000 {
		 compatible = "renesas,r8a7796-csi2";
		 reg = <0 0xfea80000 0 0x10000>;
		 interrupts = <0 184 IRQ_TYPE_LEVEL_HIGH>;
		 clocks = <&cpg CPG_MOD 714>;
		 power-domains = <&sysc R8A7796_PD_ALWAYS_ON>;
		 status = "disabled";

		 ports {
			 #address-cells = <1>;
			 #size-cells = <0>;

			 port@1 {
				 #address-cells = <1>;
				 #size-cells = <0>;

				 reg = <1>;

				 csi20vin0: endpoint@0 {
					 reg = <0>;
					 remote-endpoint = <&vin0csi20>;
				 };
				 csi20vin1: endpoint@1 {
					 reg = <1>;
					 remote-endpoint = <&vin1csi20>;
				 };
				 csi20vin2: endpoint@2 {
					 reg = <2>;
					 remote-endpoint = <&vin2csi20>;
				 };
				 csi20vin3: endpoint@3 {
					 reg = <3>;
					 remote-endpoint = <&vin3csi20>;
				 };
				 csi20vin4: endpoint@4 {
					 reg = <4>;
					 remote-endpoint = <&vin4csi20>;
				 };
				 csi20vin5: endpoint@5 {
					 reg = <5>;
					 remote-endpoint = <&vin5csi20>;
				 };
				 csi20vin6: endpoint@6 {
					 reg = <6>;
					 remote-endpoint = <&vin6csi20>;
				 };
				 csi20vin7: endpoint@7 {
					 reg = <7>;
					 remote-endpoint = <&vin7csi20>;
				 };
			 };
		 };
	 };

/* Board properties */

	&csi20 {
		status = "okay";

		ports {
			#address-cells = <1>;
			#size-cells = <0>;

			port@0 {
				reg = <0>;
				csi20_in: endpoint@0 {
					clock-lanes = <0>;
					data-lanes = <1>;
					remote-endpoint = <&adv7482_txb>;
				};
			};
		};
	};
```

## Documentation/devicetree/bindings/media/rcar_vin.txt
```
Renesas RCar Video Input driver (rcar_vin)
------------------------------------------

The rcar_vin device provides video input capabilities for the Renesas R-Car
family of devices.

On Gen2 the current blocks are always slaves and support one input channel
which can be either RGB, YUYV or BT656. On Gen3 the current blocks are
always slaves and support multiple input channels which can be either RGB,
YUVU, BT656 or CSI-2.

 - compatible: Must be one or more of the following
   - "renesas,vin-r8a7796" for the R8A7796 device
   - "renesas,vin-r8a7795" for the R8A7795 device
   - "renesas,vin-r8a7794" for the R8A7794 device
   - "renesas,vin-r8a7793" for the R8A7793 device
   - "renesas,vin-r8a7792" for the R8A7792 device
   - "renesas,vin-r8a7791" for the R8A7791 device
   - "renesas,vin-r8a7790" for the R8A7790 device
   - "renesas,vin-r8a7779" for the R8A7779 device
   - "renesas,vin-r8a7778" for the R8A7778 device
   - "renesas,rcar-gen2-vin" for a generic R-Car Gen2 compatible device.
   - "renesas,rcar-gen3-vin" for a generic R-Car Gen3 compatible device.

   When compatible with the generic version nodes must list the
   SoC-specific version corresponding to the platform first
   followed by the generic version.

 - reg: the register base and size for the device registers
 - interrupts: the interrupt for the device
 - clocks: Reference to the parent clock

Additionally, an alias named vinX will need to be created to specify
which video input device this is.

The per-board settings Gen2:
 - port sub-node describing a single endpoint connected to the vin
   as described in video-interfaces.txt[1]. Only the first one will
   be considered as each vin interface has one input port.

   These settings are used to work out video input format and widths
   into the system.

The per-board settings Gen3:

- renesas,id - ID number of the VIN
- ports
        - port@0 - Digital video source (same as port node on Gen2)
        - port@1 - CSI-2 video sources
                -reg 0 - sub-node describing the endpoint which is CSI20
                -reg 1 - sub-node describing the endpoint which is CSI21
                -reg 2 - sub-node describing the endpoint which is CSI40
                -reg 3 - sub-node describing the endpoint which is CSI41

Device node example Gen2
------------------------

        aliases {
                vin0 = &vin0;
        };

        vin0: vin@0xe6ef0000 {
                compatible = "renesas,vin-r8a7790", "renesas,rcar-gen2-vin";
                clocks = <&mstp8_clks R8A7790_CLK_VIN0>;
                reg = <0 0xe6ef0000 0 0x1000>;
                interrupts = <0 188 IRQ_TYPE_LEVEL_HIGH>;
                status = "disabled";
        };

Board setup example Gen2 (vin1 composite video input)
-----------------------------------------------------

&i2c2   {
        status = "ok";
        pinctrl-0 = <&i2c2_pins>;
        pinctrl-names = "default";

        adv7180@20 {
                compatible = "adi,adv7180";
                reg = <0x20>;
                remote = <&vin1>;

                port {
                        adv7180: endpoint {
                                bus-width = <8>;
                                remote-endpoint = <&vin1ep0>;
                        };
                };
        };
};

/* composite video input */
&vin1 {
        pinctrl-0 = <&vin1_pins>;
        pinctrl-names = "default";

        status = "ok";

        port {
                #address-cells = <1>;
                #size-cells = <0>;

                vin1ep0: endpoint {
                        remote-endpoint = <&adv7180>;
                        bus-width = <8>;
                };
        };
};

Device node example Gen3
------------------------

        vin0: video@e6ef0000 {
                compatible = "renesas,vin-r8a7795";
                reg = <0 0xe6ef0000 0 0x1000>;
                interrupts = <0 188 IRQ_TYPE_LEVEL_HIGH>;
                clocks = <&cpg CPG_MOD 811>;
                power-domains = <&sysc R8A7795_PD_ALWAYS_ON>;
                status = "disabled";

                renesas,id = <0>;

                ports {
                        #address-cells = <1>;
                        #size-cells = <0>;

                        port@1 {
                                #address-cells = <1>;
                                #size-cells = <0>;

                                reg = <1>;

                                vin0csi20: endpoint@0 {
                                        reg = <0>;
                                        remote-endpoint= <&csi20vin0>;
                                };
                                vin0csi21: endpoint@1 {
                                        reg = <1>;
                                        remote-endpoint= <&csi21vin0>;
                                };
                                vin0csi40: endpoint@2 {
                                        reg = <2>;
                                        remote-endpoint= <&csi40vin0>;
                                };
                        };
                };
        };

        csi20: csi2@fea80000 {
                compatible = "renesas,r8a7795-csi2", "renesas,rcar-gen3-csi2";
                reg = <0 0xfea80000 0 0x10000>;
                interrupts = <0 184 IRQ_TYPE_LEVEL_HIGH>;
                clocks = <&cpg CPG_MOD 714>;
                power-domains = <&sysc R8A7795_PD_ALWAYS_ON>;
                status = "disabled";

                ports {
                        #address-cells = <1>;
                        #size-cells = <0>;

                        port@1 {
                                #address-cells = <1>;
                                #size-cells = <0>;

                                reg = <1>;

                                csi20vin0: endpoint@0 {
                                        remote-endpoint = <&vin0csi20>;
                                };
                        };
                };
        };


Board setup example Gen3 (CSI-2)
--------------------------------

        &vin0 {
                status = "okay";
        };

        csi20 {
                status = "okay";

                ports {
                        #address-cells = <1>;
                        #size-cells = <0>;

                        port@0 {
                                reg = <0>;
                                csi20_in: endpoint@0 {
                                        clock-lanes = <0>;
                                        data-lanes = <1>;
                                        remote-endpoint = <&adv7482_txb>;
                                };
                        };
                };
        };

[1] video-interfaces.txt common video media interface
```

## Documentation/devicetree/bindings/media/renesas,fdp1.txt
```
Renesas R-Car Fine Display Processor (FDP1)
-------------------------------------------

The FDP1 is a de-interlacing module which converts interlaced video to
progressive video. It is capable of performing pixel format conversion between
YCbCr/YUV formats and RGB formats. Only YCbCr/YUV formats are supported as
an input to the module.

 - compatible: Must be the following

   - "renesas,fdp1" for generic compatible

 - reg: the register base and size for the device registers
 - interrupts : interrupt specifier for the FDP1 instance
 - clocks: reference to the functional clock
 - renesas,fcp: reference to the FCPF connected to the FDP1

Optional properties:
 - power-domains : power-domain property defined with a power domain specifier
                            to respective power domain.


Device node example
-------------------

	fdp1@fe940000 {
		compatible = "renesas,fdp1";
		reg = <0 0xfe940000 0 0x2400>;
		interrupts = <GIC_SPI 262 IRQ_TYPE_LEVEL_HIGH>;
		clocks = <&cpg CPG_MOD 119>;
		power-domains = <&sysc R8A7795_PD_A3VP>;
		renesas,fcp = <&fcpf0>;
	};
```

## Documentation/devicetree/bindings/media/renesas,isp.txt
```
Renesas R-Car ISP
------------------------

The R-Car device provides Channel selector of ISP (Image Signal Processor)
capabilities for the Renesas R-Car. It is used in conjunction with
the R-Car VIN module, which provides the video capture capabilities.

Mandatory properties
--------------------
 - compatible: Must be one or more of the following
   - "renesas,isp-r8a779a0" for the R8A779A0 device.

 - reg: the register base and size for the device registers
 - interrupts: the interrupt for the device
 - clocks: A phandle + clock specifier for the module clock
 - resets: A phandle + reset specifier for the module reset

Example:

		isp0: isp@fed00000 {
			compatible = "renesas,isp-r8a779a0";
			reg = <0 0xfed00000 0 0x10000>;
			interrupts = <GIC_SPI 153 IRQ_TYPE_LEVEL_HIGH>;
			clocks = <&cpg CPG_MOD 612>;
			power-domains = <&sysc R8A779A0_PD_A3ISP01>;
			resets = <&cpg 612>;
			renesas,id = <0>;
		};

		vin00: video@e6ef0000 {
			compatible = "renesas,vin-r8a779a0", "generic-uio";
			reg = <0 0xe6ef0000 0 0x1000>;
			interrupts = <GIC_SPI 160 IRQ_TYPE_LEVEL_HIGH>;
			clocks = <&cpg CPG_MOD 730>;
			power-domains = <&sysc R8A779A0_PD_ALWAYS_ON>;
			resets = <&cpg 730>;
			renesas,id = <0>;
			renesas,isp = <&isp0>;
			linux,uio-name = "vin_00";
			status = "disabled";
			ipmmu-id = <RCAR_IPMMU_VI0>;

			ports {
				#address-cells = <1>;
				#size-cells = <0>;

				port@1 {
					#address-cells = <1>;
					#size-cells = <0>;

					reg = <1>;

					vin0csi40: endpoint@0 {
						reg = <0>;
						remote-endpoint = <&csi40vin0>;
					};
				};
			};
		};
```
