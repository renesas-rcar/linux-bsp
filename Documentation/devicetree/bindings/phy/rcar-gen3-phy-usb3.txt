## Documentation/devicetree/bindings/power/renesas,sysc-rcar.txt
```
DT bindings for the Renesas R-Car System Controller

== System Controller Node ==

The R-Car System Controller provides power management for the CPU cores and
various coprocessors.

Required properties:
  - compatible: Must contain one or more of the following:
      - "renesas,r8a7779-sysc" (R-Car H1)
      - "renesas,r8a7790-sysc" (R-Car H2)
      - "renesas,r8a7791-sysc" (R-Car M2-W)
      - "renesas,r8a7792-sysc" (R-Car V2H)
      - "renesas,r8a7793-sysc" (R-Car M2-N)
      - "renesas,r8a7794-sysc" (R-Car E2)
      - "renesas,r8a7795-sysc" (R-Car H3)
      - "renesas,rcar-gen2-sysc" (Generic R-Car Gen2)
      - "renesas,rcar-gen3-sysc" (Generic R-Car Gen3)
    When compatible with the generic version, nodes must list the SoC-specific
    version corresponding to the platform first, followed by the generic
    version.
  - reg: Address start and address range for the device.
  - pm-domains: This node contains a hierarchy of PM Domain Nodes.
    Dependencies (e.g. parent SCUs should not be powered off while child CPUs
    are on) should be reflected using subnodes.


== PM Domain Nodes ==

Each of the PM domain nodes represents a PM domain, as documented by the
generic PM domain bindings in
Documentation/devicetree/bindings/power/power_domain.txt.

Required properties:
  - #power-domain-cells: Must be 0.
  - reg: This property must contain 2 values:
	   - The first value is the number of the interrupt bit representing
	     the power area in the various Interrupt Registers (e.g. SYSCISR,
	     Interrupt Status Register),
	   - The second value encodes the power register block offset (which is
	     a multiple of 64), and the number of the bit representing the
	     power area in the various Power Control Registers (e.g. PWROFFSR,
	     Power Shutoff Status Register). This value is created by ORing
	     these two numbers.
	 The parent's node must contain the following two properties:
	   - #address-cells: Must be 2,
	   - #size-cells: Must be 0.


Example:

	sysc: system-controller@e6180000 {
		compatible = "renesas,r8a7791-sysc", "renesas,rcar-gen2-sysc";
		reg = <0 0xe6180000 0 0x0200>;

		pm-domains {
			#address-cells = <2>;
			#size-cells = <0>;

			pd_ca15_scu: scu@12 {
				reg = <12 0x180>;
				#address-cells = <2>;
				#size-cells = <0>;
				#power-domain-cells = <0>;

				pd_ca15_cpu0: cpu@0 {
					reg = <0 0x40>;
					#power-domain-cells = <0>;
				};

				pd_ca15_cpu1: cpu@1 {
					reg = <1 0x41>;
					#power-domain-cells = <0>;
				};
			};

			pd_sh: sh@16 {
				reg = <16 0x80>;
				#power-domain-cells = <0>;
			};

			pd_sgx: sgx@20 {
				reg = <20 0xc0>;
				#power-domain-cells = <0>;
			};
		};
	};
```

## Documentation/devicetree/bindings/regulator/qcom,saw-regulator.txt
```
Qualcomm SAW Regulators

SAW (Subsystem Power Manager and Adaptive Voltage Scaling Wrapper) is a hardware
block in the Qualcomm chipsets that regulates the power to the CPU cores on devices
such as APQ8064, MSM8974, APQ8084 and others.

- compatible:
	Usage: required
	Value type: <string>
	Definition: must be one of:
			"qcom,apq8064-saw2-v1.1-regulator"

Example:
                saw0: power-controller@2089000 {
			compatible = "qcom,apq8064-saw2-v1.1-cpu", "qcom,saw2", "syscon", "simple-mfd";
			reg = <0x02089000 0x1000>, <0x02009000 0x1000>;
			#address-cells = <1>;
			#size-cells = <1>;

			saw0_regulator: regulator@2089000 {
				compatible = "qcom,apq8064-saw2-v1.1-regulator";
				regulator-always-on;
				regulator-min-microvolt = <825000>;
				regulator-max-microvolt = <1250000>;
			};
		};


		&CPU0 {
			cpu-supply = <&saw0_regulator>;
		};
```

## Documentation/devicetree/bindings/renesas,mailbox.yaml
```yaml
# SPDX-License-Identifier: (GPL-2.0-only OR BSD-2-Clause)
%YAML 1.2
---
$id: "http://devicetree.org/schemas/renesas/renesas,mfis-mailbox.yaml#"
$schema: "http://devicetree.org/meta-schemas/core.yaml#"

title: Renesas R-Car Multifunctional Interface

maintainers:

description: |
    The R-Car multifunctional interface (MFIS) provides an interface between
    the different CPU Cores, such as AP System Core domain and the Realtime
    Core domain, SCP Core domain and AP System Core domain or Realtime Core
    domain and AP System Core domain or Realtime Core domain.
    The MFIS supports the issuing of interrupts for each CPU core domain.

properties:
  compatible:
    enum:
      - renesas,mfis-mbox

  reg:
    maxItems:

required:
  - compatible
  - reg

additionalProperties: false

examples:
  - |
    mailbox: mfis_mbox {
            compatible = "renesas,mfis-mbox";
            #mbox-cells = <1>;
            reg = <0x0 0x1881f000 0x0 0x4>;
            interrupts = <GIC_SPI 4391 IRQ_TYPE_LEVEL_HIGH>;
    };
```

## Documentation/devicetree/bindings/rtc/renesas,rtc-rcar.yaml
```yaml
# SPDX-License-Identifier: (GPL-2.0-only OR BSD-2-Clause)
%YAML 1.2
---
title: Renesas R-Car SoCs Real-Time Clock

maintainers:
  - Khanh Le <khanh.le.xr@renesas.com>

allOf:
  - $ref: rtc.yaml#

properties:
  compatible:
    items:
      - enum:
          - renesas,rtc-r8a78000    # R-Car X5H
      - const: renesas,rtc-rcar

  reg:
    maxItems: 1

  interrupts:
    maxItems: 3

  interrupt-names:
    items:
      - const: update
      - const: alarm
      - const: period

  clocks:
    maxItems: 1

  clock-names:
    const: ref_clk

required:
  - compatible
  - reg
  - clocks
  - clock-names

examples:
  - |
    rtca@c1394000 {
       compatible = "renesas,rtc-rcar";
       reg = <0 0xc1394000 0 0x70>;
       clocks = <&dummy_tcki>;
       clock-names = "ref_clk";
       interrupts = <GIC_SPI 464 IRQ_TYPE_LEVEL_HIGH>,
		    <GIC_SPI 465 IRQ_TYPE_LEVEL_HIGH>,
		    <GIC_SPI 466 IRQ_TYPE_LEVEL_HIGH>;
       interrupt-names = "update", "alarm", "period";
    };
```

## Documentation/devicetree/bindings/soc/renesas/renesas,sysc-rcar.txt
```
DT bindings for the Renesas R-Car System Controller/Power Domains Driver

== System Controller Node ==

The R-Car System Controller provides the following functions:
  - Control power-shutoff and resume sequence of power domains.
  - Call to clock driver to turn on/off module stop clock for
	on-chip drivers (via pm_runtime apis.)

Required properties:
- compatible: Should be "renesas,rcar-gen3-sysc"
		or "renesas,rcar-gen2-sysc" as fallback.

- reg: Compose start address and address range blocks for the device.

Optional nodes:
- pm-domains: This node contains a hierarchy of PM domain nodes, which should
  match the Power Area Hierarchy in the Power Domain Specifications section of
  the device's datasheet.

== PM Domain Nodes ==

Each of the PM domain nodes represents a PM domain, as documented by the
generic PM domain bindings in
Documentation/devicetree/bindings/power/power_domain.txt.

The nodes should be named by the real power area names, and thus their names
should be unique.

Required properties:
  - #power-domain-cells: Must be 0.

Optional properties:
- reg: If the PM domain is not always-on, this property must contain the
	the off-set of power domain's base address from sysc's base address.
	Its parent node must contain the following two properties:
	 - #address-cells: Must be 1,
	 - #size-cells: Must be 0.
       If the PM domain is always-on, this property must be omitted.

Example:

This shows a subset of the r8a7795 PM domain hierarchy, containing the
"always-on" domain, 4 its power subdomains (a3sg, a3ir, a3vp, a3vc);
and the a2vc0, a2vc1 domains; which are subdomains of a3vc.

		sysc: system-controller@e6180000 {
			compatible = "renesas,rcar-gen3-sysc";
			reg = <0 0xe6180000 0 0x0400>;

			pm-domains {
				pd_always_on: always_on {
					#address-cells = <1>;
					#size-cells = <0>;
					#power-domain-cells = <0>;

					pd_a3sg: a3sg {
						reg = <0x0100>;
						#power-domain-cells = <0>;
					};

					pd_a3ir: a3ir {
						reg = <0x0180>;
						#power-domain-cells = <0>;
					};

					pd_a3vp: a3vp {
						reg = <0x0340>;
						#power-domain-cells = <0>;
					};

					pd_a3vc: a3vc {
						reg = <0x0380>;
						#address-cells = <1>;
						#size-cells = <0>;
						#power-domain-cells = <0>;

						pd_a2vc0: a2vc0 {
							reg = <0x03C0>;
							#power-domain-cells = <0>;
						};

						pd_a2vc1: a2vc1 {
							reg = <0x03C0>;
							#power-domain-cells = <0>;
						};
					};
				};
			};
		};

== PM Domain Consumers ==
Hardware blocks belonging to a PM domain should contain a "power-domains"
property that is a phandle pointing to the corresponding PM domain node.

This way is also applied for hardware blocks that belong to "always-on" domain,
they should be kept as "power-domains = <&pd_always_on>;

Example:

 - 3D-graphic hardware module belong to "a3sg" power domain, add "power-domains" field as:
	gsx: gsx@fd000000 {
		compatible = "renesas,gsx";
		reg = <0 0xfd000000 0 0x3ffff>;
		interrupts = <GIC_SPI 119 IRQ_TYPE_LEVEL_HIGH>;
		clocks = <&cpg CPG_MOD 112>;
		power-domains = <&pd_a3sg>;
	};

 - GPO7 hardware module belong to "always-on" power domain, add "power-domains" field as:
    gpio7: gpio@e6055800 {
            compatible = "renesas,gpio-r8a7795",
                         "renesas,gpio-rcar";
            reg = <0 0xe6055800 0 0x50>;
            interrupts = <GIC_SPI 11 IRQ_TYPE_LEVEL_HIGH>;
            #gpio-cells = <2>;
            gpio-controller;
            gpio-ranges = <&pfc 0 224 4>;
            #interrupt-cells = <2>;
            interrupt-controller;
            clocks = <&cpg CPG_MOD 905>;
            power-domains = <&pd_always_on>;
    };
```

## Documentation/devicetree/bindings/sound/ak4619.txt
```
AK4619 I2C transmitter

This device supports I2C mode only.

Required properties:

- compatible : "asahi-kasei,ak4619"
- reg : The I2C address of the device.

Optional properties:

- pdn-gpios: A GPIO specifier for the PDN pin.
- mode-gpios: A GPIO specifier for playback/capture data path pin switch.

Example:

&i2c {
       ak4619: ak4619@10 {
               compatible = "asahi-kasei,ak4619";
               reg = <0x10>;
               mode-gpios = <&gpio0 1 GPIO_ACTIVE_HIGH>;
               pdn-gpios = <&gpio1 8 GPIO_ACTIVE_HIGH>;
       };
};
```

## Documentation/devicetree/bindings/thermal/rcar-gen3-ems.yaml
```yaml
# SPDX-License-Identifier: GPL-2.0-only OR BSD-2-Clause
# Copyright (C) 2020 Renesas Electronics Corp.
%YAML 1.2
---
$id: http://devicetree.org/schemas/thermal/rcar-gen3-ems.yaml#
$schema: http://devicetree.org/meta-schemas/core.yaml#

title: Renesas R-Car Gen3 Emergency shutdown(EMS)

description:
Emergency shutdown functionality provides the specific cooling mechanism
for R-Car Gen3. In case of high temperature(e.g over 100 degrees),
it has the ability to rapidly cool down the system.

properties:
  compatible:
    enum:
      - renesas,r8a7795-thermal  # R-Car H3
      - renesas,r8a7796-thermal  # R-Car M3-W
      - renesas,r8a77961-thermal # R-Car M3-W+
      - renesas,r8a77965-thermal # R-Car M3-N
      - renesas,r8a77980-thermal # R-Car V3H

  polling-delay:
    type: unsigned
    description:
        The maximum number of milliseconds to wait between polls
        when checking temperature for emergency shutdown.

  on-temperature:
    type: unsigned
    description:
        This value indicates the emergency temperature to invoke
        emergency shutdown functionality when exceeding this temperature.

  off-temperature:
    type: unsigned
    description:
        This value indicates the emergency temperature to bring
        the system back to normal operation when being lower
        this temperature.

  status:
    type: string
    description: Should be "disabled" always.

  target_cpus:
    type: phandle
    description:
        This property indicates which CPU will be targeted for shutdown.

required:
  - polling-delay
  - on-temperature
  - off-temperature
  - status
  - target_cpus

examples:
  -
    #include <dt-bindings/interrupt-controller/arm-gic.h>
    #include <dt-bindings/power/r8a7795-sysc.h>

    thermal-zones {
        emergency {
            polling-delay = <1000>;    /* milliseconds */
            on-temperature = <110000>; /* millicelsius */
            off-temperature = <95000>; /* millicelsius */
            target_cpus = <&a57_1>,
                      <&a57_2>,
                      <&a57_3>;
            status = "disabled";
        };
    };
```

## Documentation/devicetree/bindings/thermal/rcar-gen3-thermal.txt
```
* Renesas R-Car Gen3 Thermal

Required properties:
- compatible		: "renesas,thermal-<soctype>",
			  Examples with soctypes are:
			    - "renesas,thermal-r8a7795" (R-Car H3)
			    - "renesas,thermal-r8a7796" (R-Car M3)
- reg			: Address range of the thermal registers.
- #thermal-sensor-cells : Please see ./thermal.txt

Option properties:

- interrupts		: use interrupt

Example (non interrupt support):

thermal: thermal@0xe6198000 {
                        compatible = "renesas,thermal-r8a7795";
                        reg = <0 0xe6198000 0 0x5c>;
                };

thermal-zones {
	cpu_thermal: cpu-thermal {
		polling-delay-passive	= <250>;
		polling-delay		= <1000>;

		thermal-sensors = <&thermal>;
	};
};

Example (interrupt support):

thermal: thermal@0xe6198000 {
                        compatible = "renesas,thermal-r8a7795";
                        reg = <0 0xe6198000 0 0x5c>;
			interrupts = <GIC_SPI 67 IRQ_TYPE_LEVEL_HIGH>;
                };

thermal-zones {
	cpu_thermal: cpu-thermal {
		polling-delay-passive	= <250>;
		polling-delay		= <0>;

		thermal-sensors = <&thermal>;
	};
};

* Emergency shutdown for R-CAR Gen3
Emergency shutdown functionality provide the specific cooling mechanism
for R-CAR Gen3. In case of high temperature(e.g over 100 degrees),
it has the ability to rapidly cooling the system.

Required property:
- polling-delay:	The maximum number of milliseconds to wait between polls
  Type: unsigned	when checking temperature for emergency shutdown.
  Size: one cell

- on-temperature:       This value indicate the emergency temperature and invoke
  Type: unsigned	emergency shutdown functionality when exceeding this
  Size: one cell	temperature.

- off-temperature:	This value indicate the temperature to disable emergency
  Type: unsigned	shutdown.
  Size: one cell

thermal-zones {
	emergency {
		polling-delay = <1000>;    /* milliseconds */
		on-temperature = <110000>; /* millicelsius */
		off-temperature = <95000>; /* millicelsius */
	};
};
```
