## Documentation/devicetree/bindings/watchdog/renesas,wwdt.yaml
```yaml
# SPDX-License-Identifier: (GPL-2.0-only OR BSD-2-Clause)
%YAML 1.2
---
$id: http://devicetree.org/schemas/watchdog/renesas,wwdt.yaml#
$schema: http://devicetree.org/meta-schemas/core.yaml#

title: Renesas Window Watchdog Timer (WWDT) Controller

maintainers:
  - Minh Le <minh.le.aj@renesas.com>

properties:
  compatible:
    oneOf:
      - items:
          - enum:
              - renesas,r8a78000-wwdt		# X5H
          - const: renesas, rcar-gen5-wwdt	# R-Car Gen5

  reg:
    maxItems: 1

  interval-time:
    description:
      The interval time is set for calculating the overflow time for the watchdog counter.

  error-mode:
    description:
      The error-mode is set to choose error mode of window watchdog when counter overflow
      or error detection behavior. By default, set is 1 to choose reset mode, 0 is NMI mode.

  irq_75p:
    description:
      The irq_75p is set to choose 75% interrupt enable for WWDT module.
      When counter reach 75% value of timeout, 75% interrupt pulse will raise up.

  wsize:
    description:
      The wsize is set the window size selection.

required:
  - compatible
  - reg

unevaluatedProperties: false

examples:
  - |
    #include <dt-bindings/clock/r8a78000-cpg-mssr.h>
    #include <dt-bindings/interrupt-controller/arm-gic.h>
    #include <dt-bindings/power/r8a78000-sysc.h>

    wwdt0: watchdog@1c100000 {
               compatible = "renesas, rcar-gen5-wwdt";
               reg = <0 0x1c100000 0 0x10000>;
               interval-time = <7>;
               error-mode = <0>;
               irq_75p = <0>;
               wsize = <2>;
               status = "okay";
    };
```

## Documentation/devicetree/bindings/watchdog/renesas-rwdt.txt
```
Renesas RCLK Watchdog Timer (RWDT) Controller

Required properties:
- compatible : Should be "renesas,rwdt-r8a7795";
- reg : Should contain WDT registers location and length
- clocks : the clock feeding the watchdog timer.

Optional properties:
- timeout-sec : Contains the watchdog timeout in seconds

Examples:

	wdt0: wdt@e6020000 {
		compatible = "renesas,rwdt-r8a7795";
		reg = <0 0xe6020000 0 0x0c>;
		clocks = <&cpg CPG_MOD 402>;
		timeout-sec = <60>;
	};
```

## arch/arm64/configs/renesas_defconfig
```kconfig
CONFIG_LOCALVERSION="-arm64-renesas"
CONFIG_SYSVIPC=y
CONFIG_POSIX_MQUEUE=y
CONFIG_AUDIT=y
CONFIG_NO_HZ_IDLE=y
CONFIG_HIGH_RES_TIMERS=y
CONFIG_IRQ_TIME_ACCOUNTING=y
CONFIG_BSD_PROCESS_ACCT=y
CONFIG_BSD_PROCESS_ACCT_V3=y
CONFIG_TASKSTATS=y
CONFIG_TASK_DELAY_ACCT=y
CONFIG_TASK_XACCT=y
CONFIG_TASK_IO_ACCOUNTING=y
CONFIG_IKCONFIG=y
CONFIG_IKCONFIG_PROC=y
CONFIG_MEMCG=y
CONFIG_MEMCG_SWAP=y
CONFIG_BLK_CGROUP=y
CONFIG_CGROUP_PIDS=y
CONFIG_CGROUP_HUGETLB=y
CONFIG_CPUSETS=y
CONFIG_CGROUP_DEVICE=y
CONFIG_CGROUP_CPUACCT=y
CONFIG_CGROUP_PERF=y
CONFIG_USER_NS=y
CONFIG_SCHED_AUTOGROUP=y
CONFIG_BLK_DEV_INITRD=y
# CONFIG_COMPAT_BRK is not set
CONFIG_PROFILING=y
CONFIG_JUMP_LABEL=y
CONFIG_BLK_DEV_INTEGRITY=y
# CONFIG_IOSCHED_DEADLINE is not set
CONFIG_ARCH_RENESAS=y
CONFIG_ARCH_R8A7795=y
CONFIG_ARCH_R8A7796=y
CONFIG_ARCH_R8A77970=y
CONFIG_ARCH_R8A77995=y
CONFIG_PCI=y
CONFIG_PCIEPORTBUS=y
CONFIG_HOTPLUG_PCI_PCIE=y
CONFIG_PCI_IOV=y
CONFIG_HOTPLUG_PCI=y
CONFIG_PCIE_RCAR=y
CONFIG_PCI_HOST_GENERIC=y
# CONFIG_CAVIUM_ERRATUM_22375 is not set
# CONFIG_CAVIUM_ERRATUM_23154 is not set
# CONFIG_CAVIUM_ERRATUM_27456 is not set
# CONFIG_CAVIUM_ERRATUM_30115 is not set
# CONFIG_QCOM_FALKOR_ERRATUM_1003 is not set
# CONFIG_QCOM_FALKOR_ERRATUM_1009 is not set
# CONFIG_QCOM_QDF2400_ERRATUM_0065 is not set
CONFIG_ARM64_VA_BITS_48=y
CONFIG_SCHED_MC=y
CONFIG_PREEMPT=y
CONFIG_KSM=y
CONFIG_TRANSPARENT_HUGEPAGE=y
CONFIG_CMA=y
CONFIG_SECCOMP=y
CONFIG_KEXEC=y
CONFIG_CRASH_DUMP=y
CONFIG_XEN=y
# CONFIG_CORE_DUMP_DEFAULT_ELF_HEADERS is not set
CONFIG_COMPAT=y
CONFIG_HIBERNATION=y
CONFIG_WQ_POWER_EFFICIENT_DEFAULT=y
CONFIG_CPU_IDLE=y
CONFIG_ARM_CPUIDLE=y
CONFIG_CPU_FREQ=y
CONFIG_CPUFREQ_DT=y
CONFIG_ARM_BIG_LITTLE_CPUFREQ=y
CONFIG_NET=y
CONFIG_PACKET=y
CONFIG_UNIX=y
CONFIG_INET=y
CONFIG_IP_MULTICAST=y
CONFIG_IP_PNP=y
CONFIG_IP_PNP_DHCP=y
CONFIG_IP_PNP_BOOTP=y
# CONFIG_IPV6 is not set
CONFIG_NETFILTER=y
CONFIG_CAN=y
CONFIG_CAN_RCAR=y
CONFIG_CAN_RCAR_CANFD=y
CONFIG_DEVTMPFS=y
CONFIG_DEVTMPFS_MOUNT=y
CONFIG_DMA_CMA=y
CONFIG_CMA_ALIGNMENT=9
CONFIG_MTD=y
CONFIG_MTD_BLOCK=y
CONFIG_MTD_SPI_NOR=y
CONFIG_BLK_DEV_LOOP=y
CONFIG_VIRTIO_BLK=y
CONFIG_SRAM=y
# CONFIG_SCSI_PROC_FS is not set
CONFIG_BLK_DEV_SD=y
CONFIG_SCSI_SAS_LIBSAS=y
CONFIG_SCSI_SAS_ATA=y
CONFIG_ATA=y
# CONFIG_SATA_PMP is not set
CONFIG_SATA_RCAR=y
CONFIG_NETDEVICES=y
CONFIG_TUN=y
CONFIG_VIRTIO_NET=y
CONFIG_RAVB=y
CONFIG_MDIO_BUS_MUX_MMIOREG=y
CONFIG_MICREL_PHY=y
# CONFIG_WLAN is not set
CONFIG_INPUT_MATRIXKMAP=y
CONFIG_INPUT_EVDEV=y
# CONFIG_KEYBOARD_ATKBD is not set
CONFIG_KEYBOARD_GPIO=y
# CONFIG_MOUSE_PS2 is not set
CONFIG_INPUT_MISC=y
# CONFIG_SERIO is not set
CONFIG_SERIAL_SH_SCI=y
CONFIG_SERIAL_SH_SCI_NR_UARTS=11
CONFIG_SERIAL_SH_SCI_CONSOLE=y
CONFIG_SERIAL_SH_SCI_DMA=y
CONFIG_VIRTIO_CONSOLE=y
# CONFIG_HW_RANDOM is not set
CONFIG_I2C_CHARDEV=y
CONFIG_I2C_MUX=y
CONFIG_I2C_DESIGNWARE_PLATFORM=y
CONFIG_I2C_SH_MOBILE=y
CONFIG_I2C_RCAR=y
CONFIG_SPI=y
CONFIG_SPI_SH_MSIOF=y
CONFIG_SPI_SPIDEV=y
CONFIG_SPMI=y
CONFIG_PINCTRL_SINGLE=y
CONFIG_GPIOLIB=y
CONFIG_GPIO_GENERIC_PLATFORM=y
CONFIG_GPIO_RCAR=y
CONFIG_GPIO_BD9571MWV=y
CONFIG_THERMAL=y
CONFIG_THERMAL_GOV_POWER_ALLOCATOR=y
CONFIG_CPU_THERMAL=y
CONFIG_THERMAL_EMULATION=y
CONFIG_RCAR_GEN3_THERMAL=y
CONFIG_WATCHDOG=y
CONFIG_RENESAS_WDT=y
CONFIG_MFD_BD9571MWV=y
CONFIG_REGULATOR=y
CONFIG_REGULATOR_FIXED_VOLTAGE=y
CONFIG_REGULATOR_BD9571MWV=y
CONFIG_REGULATOR_GPIO=y
CONFIG_REGULATOR_PWM=y
# CONFIG_RC_CORE is not set
CONFIG_MEDIA_SUPPORT=y
CONFIG_MEDIA_CAMERA_SUPPORT=y
CONFIG_MEDIA_SDR_SUPPORT=y
CONFIG_MEDIA_CONTROLLER=y
CONFIG_VIDEO_V4L2_SUBDEV_API=y
CONFIG_V4L_PLATFORM_DRIVERS=y
CONFIG_VIDEO_RCAR_VIN=y
CONFIG_V4L_MEM2MEM_DRIVERS=y
CONFIG_VIDEO_RENESAS_FDP1=y
CONFIG_VIDEO_RENESAS_FCP=y
CONFIG_VIDEO_RENESAS_VSP1=y
CONFIG_SDR_PLATFORM_DRIVERS=y
CONFIG_VIDEO_RCAR_DRIF=y
# CONFIG_MEDIA_SUBDRV_AUTOSELECT is not set
CONFIG_VIDEO_ADV748X=y
# CONFIG_MEDIA_TUNER_SIMPLE is not set
# CONFIG_MEDIA_TUNER_TDA8290 is not set
# CONFIG_MEDIA_TUNER_TDA827X is not set
# CONFIG_MEDIA_TUNER_TDA18271 is not set
# CONFIG_MEDIA_TUNER_TDA9887 is not set
# CONFIG_MEDIA_TUNER_TEA5761 is not set
# CONFIG_MEDIA_TUNER_TEA5767 is not set
# CONFIG_MEDIA_TUNER_MSI001 is not set
# CONFIG_MEDIA_TUNER_MT20XX is not set
# CONFIG_MEDIA_TUNER_MT2060 is not set
# CONFIG_MEDIA_TUNER_MT2063 is not set
# CONFIG_MEDIA_TUNER_MT2266 is not set
# CONFIG_MEDIA_TUNER_MT2131 is not set
# CONFIG_MEDIA_TUNER_QT1010 is not set
# CONFIG_MEDIA_TUNER_XC2028 is not set
# CONFIG_MEDIA_TUNER_XC5000 is not set
# CONFIG_MEDIA_TUNER_XC4000 is not set
# CONFIG_MEDIA_TUNER_MXL5005S is not set
# CONFIG_MEDIA_TUNER_MXL5007T is not set
# CONFIG_MEDIA_TUNER_MC44S803 is not set
# CONFIG_MEDIA_TUNER_MAX2165 is not set
# CONFIG_MEDIA_TUNER_TDA18218 is not set
# CONFIG_MEDIA_TUNER_FC0011 is not set
# CONFIG_MEDIA_TUNER_FC0012 is not set
# CONFIG_MEDIA_TUNER_FC0013 is not set
# CONFIG_MEDIA_TUNER_TDA18212 is not set
# CONFIG_MEDIA_TUNER_E4000 is not set
# CONFIG_MEDIA_TUNER_FC2580 is not set
# CONFIG_MEDIA_TUNER_M88RS6000T is not set
# CONFIG_MEDIA_TUNER_TUA9001 is not set
# CONFIG_MEDIA_TUNER_SI2157 is not set
# CONFIG_MEDIA_TUNER_IT913X is not set
# CONFIG_MEDIA_TUNER_R820T is not set
# CONFIG_MEDIA_TUNER_MXL301RF is not set
# CONFIG_MEDIA_TUNER_QM1D1C0042 is not set
CONFIG_DRM=y
CONFIG_DRM_RCAR_DU=y
CONFIG_DRM_RCAR_DW_HDMI=y
CONFIG_DRM_RCAR_LVDS=y
CONFIG_DRM_RCAR_VSP=y
CONFIG_DRM_DUMB_VGA_DAC=y
CONFIG_DRM_DW_HDMI_AHB_AUDIO=y
CONFIG_DRM_DW_HDMI_I2S_AUDIO=y
CONFIG_DRM_DW_HDMI_CEC=y
CONFIG_FB_MODE_HELPERS=y
CONFIG_BACKLIGHT_LCD_SUPPORT=y
# CONFIG_LCD_CLASS_DEVICE is not set
# CONFIG_BACKLIGHT_GENERIC is not set
CONFIG_BACKLIGHT_PWM=y
CONFIG_LOGO=y
# CONFIG_LOGO_LINUX_MONO is not set
# CONFIG_LOGO_LINUX_VGA16 is not set
CONFIG_SOUND=y
CONFIG_SND=y
# CONFIG_SND_SPI is not set
# CONFIG_SND_USB is not set
CONFIG_SND_SOC=y
CONFIG_SND_SOC_RCAR=y
CONFIG_SND_SOC_AK4613=y
CONFIG_SND_SIMPLE_CARD=y
CONFIG_USB=y
CONFIG_USB_OTG=y
CONFIG_USB_XHCI_HCD=y
CONFIG_USB_XHCI_PLATFORM=y
CONFIG_USB_EHCI_HCD=y
CONFIG_USB_EHCI_ROOT_HUB_TT=y
CONFIG_USB_EHCI_HCD_PLATFORM=y
CONFIG_USB_OHCI_HCD=y
CONFIG_USB_OHCI_HCD_PLATFORM=y
CONFIG_USB_RENESAS_USBHS_HCD=y
CONFIG_USB_RENESAS_USBHS=y
CONFIG_USB_STORAGE=y
CONFIG_USB_HSIC_USB3503=y
CONFIG_NOP_USB_XCEIV=y
CONFIG_USB_ULPI=y
CONFIG_USB_GADGET=y
CONFIG_USB_RENESAS_USBHS_UDC=y
CONFIG_USB_RENESAS_USB3=y
CONFIG_USB_SNP_UDC_PLAT=y
CONFIG_USB_BDC_UDC=y
CONFIG_MMC=y
CONFIG_MMC_SDHI=y
CONFIG_NEW_LEDS=y
CONFIG_LEDS_CLASS=y
CONFIG_LEDS_GPIO=y
CONFIG_LEDS_PWM=y
CONFIG_LEDS_TRIGGERS=y
CONFIG_LEDS_TRIGGER_HEARTBEAT=y
CONFIG_LEDS_TRIGGER_CPU=y
CONFIG_LEDS_TRIGGER_DEFAULT_ON=y
CONFIG_EDAC=y
CONFIG_RTC_CLASS=y
CONFIG_DMADEVICES=y
CONFIG_RCAR_DMAC=y
CONFIG_RENESAS_USB_DMAC=y
CONFIG_VFIO=y
CONFIG_VFIO_PCI=y
CONFIG_VIRTIO_PCI=y
CONFIG_VIRTIO_BALLOON=y
CONFIG_VIRTIO_MMIO=y
CONFIG_CHROME_PLATFORMS=y
CONFIG_COMMON_CLK_CS2000_CP=y
# CONFIG_COMMON_CLK_XGENE is not set
CONFIG_COMMON_CLK_VC5=y
CONFIG_CLK_RCAR_USB2_CLOCK_SEL=y
CONFIG_HWSPINLOCK=y
# CONFIG_FSL_ERRATUM_A008585 is not set
# CONFIG_HISILICON_ERRATUM_161010101 is not set
# CONFIG_ARM64_ERRATUM_858921 is not set
CONFIG_MAILBOX=y
CONFIG_IOMMU_IO_PGTABLE_LPAE=y
CONFIG_EXTCON_USB_GPIO=y
CONFIG_IIO=y
CONFIG_MAX9611=y
CONFIG_PWM=y
CONFIG_PWM_RCAR=y
CONFIG_RESET_CONTROLLER=y
CONFIG_PHY_RCAR_GEN3_USB2=y
CONFIG_PHY_RCAR_GEN3_USB3=y
CONFIG_TEE=y
CONFIG_OPTEE=y
# CONFIG_DMIID is not set
CONFIG_EXT4_FS=y
CONFIG_EXT4_FS_POSIX_ACL=y
CONFIG_FANOTIFY=y
CONFIG_QUOTA=y
CONFIG_AUTOFS4_FS=y
CONFIG_VFAT_FS=y
CONFIG_TMPFS=y
CONFIG_HUGETLBFS=y
CONFIG_CONFIGFS_FS=y
CONFIG_SQUASHFS=y
CONFIG_NFS_FS=y
CONFIG_NFS_V4=y
CONFIG_NFS_V4_1=y
CONFIG_NFS_V4_2=y
CONFIG_ROOT_NFS=y
CONFIG_NLS_CODEPAGE_437=y
CONFIG_NLS_ISO8859_1=y
CONFIG_VIRTUALIZATION=y
CONFIG_KVM=y
CONFIG_PRINTK_TIME=y
CONFIG_DEBUG_FS=y
CONFIG_MAGIC_SYSRQ=y
CONFIG_DEBUG_KERNEL=y
# CONFIG_SCHED_DEBUG is not set
# CONFIG_DEBUG_PREEMPT is not set
CONFIG_PROVE_LOCKING=y
# CONFIG_FTRACE is not set
CONFIG_CRYPTO_ANSI_CPRNG=y
# CONFIG_CRYPTO_DEV_VIRTIO is not set
CONFIG_ARM64_CRYPTO=y
CONFIG_CRYPTO_SHA1_ARM64_CE=y
CONFIG_CRYPTO_SHA2_ARM64_CE=y
CONFIG_CRYPTO_GHASH_ARM64_CE=y
CONFIG_CRYPTO_AES_ARM64_CE_CCM=y
CONFIG_CRYPTO_AES_ARM64_CE_BLK=y
```

## drivers/gpu/drm/rcar-rvgc/Kconfig
```kconfig
config DRM_RCAR_RVGC
	tristate "DRM Support for R-Car Virtual Graphics Card"
	depends on DRM
	depends on ARM || ARM64
	depends on ARCH_RENESAS || COMPILE_TEST
	select DRM_KMS_HELPER
	select DRM_KMS_CMA_HELPER
	select DRM_GEM_CMA_HELPER
	select VIDEOMODE_HELPERS
	select RCAR_MFIS
	select RPMSG
	help
	  Choose this option if you have an R-Car chipset.
```

## drivers/media/i2c/fpdlink/Kconfig
```kconfig
#
# GMSL video device configuration
#

config VIDEO_UB9X4
	tristate "TI DS90UB960 FPDLink3 deserializer support"
	depends on I2C && I2C_MUX
	depends on VIDEO_V4L2_SUBDEV_API && MEDIA_CONTROLLER
	select V4L2_FWNODE
	help
	  This is a Texas Instruments DS90UB960/UB954/UB964 FPDLink3
	  deserializer driver

	  To compile this driver as a module, choose M here: the
	  module will be called ub9x4.
```

## drivers/media/i2c/gmsl/Kconfig
```kconfig
#
# GMSL video device configuration
#

config VIDEO_MAX9286_STAGING
	tristate "MAXIM MAX9286 GMSL deserializer support for ov10635"
	depends on I2C && I2C_MUX
	depends on OF_GPIO
	select V4L2_FWNODE
	select VIDEO_V4L2_SUBDEV_API
	select MEDIA_CONTROLLER
	help
	  This is a MAXIM MAX9286 GMSL deserializer driver

	  To compile this driver as a module, choose M here: the
	  module will be called max9286.

config VIDEO_MAX9288
	tristate "MAXIM MAX9288 GMSL deserializer support"
	depends on I2C && I2C_MUX
	depends on OF_GPIO
	select V4L2_FWNODE
	select VIDEO_V4L2_SUBDEV_API
	select MEDIA_CONTROLLER
	help
	  This is a MAXIM MAX9288 GMSL deserializer driver

	  To compile this driver as a module, choose M here: the
	  module will be called max9288.

config VIDEO_MAX9296
	tristate "MAXIM MAX9296 GMSL2 deserializer support"
	depends on I2C && I2C_MUX
	depends on OF_GPIO
	select V4L2_FWNODE
	select VIDEO_V4L2_SUBDEV_API
	select MEDIA_CONTROLLER
	help
	  This is a MAXIM MAX9296 GMSL2 deserializer driver

	  To compile this driver as a module, choose M here: the
	  module will be called max9296.

config VIDEO_MAX96712
	tristate "MAXIM MAX96712 GMSL2 deserializer support"
	depends on I2C && I2C_MUX
	depends on OF_GPIO
	select V4L2_FWNODE
	select VIDEO_V4L2_SUBDEV_API
	select MEDIA_CONTROLLER
	help
	  This is a MAXIM MAX96712 GMSL2 deserializer driver

	  To compile this driver as a module, choose M here: the
	  module will be called max96712.
```

## drivers/media/i2c/imagers/Kconfig
```kconfig
#
# LVDS camera video device configuration
#

config VIDEO_LVDS_CAMERA
	tristate "LVDS camera support"
	depends on I2C && VIDEO_V4L2_SUBDEV_API && MEDIA_CONTROLLER
	select V4L2_FWNODE
	help
	  This is a GMSL/FPDLink cameras support

	  This camera should be used in conjunction with a GMSL or
	  or FPDLink deserialiser
```

## drivers/media/platform/rcar-vin/Kconfig
```kconfig
config VIDEO_RCAR_CSI2
	tristate "R-Car MIPI CSI-2 Receiver"
	depends on VIDEO_V4L2 && VIDEO_V4L2_SUBDEV_API && OF
	depends on ARCH_RENESAS || COMPILE_TEST
	---help---
	  Support for Renesas R-Car MIPI CSI-2 receiver.
	  Supports R-Car Gen3 SoCs.

	  To compile this driver as a module, choose M here: the
	  module will be called rcar-csi2.

config VIDEO_RCAR_VIN
	tristate "R-Car Video Input (VIN) Driver"
	depends on VIDEO_V4L2 && VIDEO_V4L2_SUBDEV_API && OF && HAS_DMA && MEDIA_CONTROLLER
	depends on ARCH_RENESAS || COMPILE_TEST
	select VIDEOBUF2_DMA_CONTIG
	---help---
	  Support for Renesas R-Car Video Input (VIN) driver.
	  Supports R-Car Gen2 SoCs.

	  To compile this driver as a module, choose M here: the
	  module will be called rcar-vin.
```

## drivers/misc/rcar-mfis/Kconfig
```kconfig
config RCAR_MFIS
       tristate "R-Car MFIS driver"
       depends on OF
       depends on ARM || ARM64
       depends on ARCH_RENESAS
       help
         MFIS (Multifunctional Interface) allows inter-processor communication for R-Car Gen3 SoC.

         To compile this driver as a module, choose M here. The module
         will be called rcar-mfis.
```

## drivers/net/can/rcar-taurus/Kconfig
```kconfig
config CAN_RCAR_TAURUS
	tristate "Renesas R-Car Taurus CAN driver"
	depends on ARCH_RENESAS || ARM
	---help---
	  Say Y here if you want to use the Renesas Taurus CAN virtual
	  driver for R-Car Gen3 SoCs.

	  To compile this driver as a module, choose M here: the module will
	  be called rcar_taurus_can.
```

## drivers/net/ethernet/renesas/rcar-taurus/Kconfig
```kconfig
config ETHER_RCAR_TAURUS
	tristate "Renesas R-Car Taurus Ethernet driver"
	depends on ARCH_RENESAS || ARM
	help
	  Say Y here if you want to use the Renesas Taurus Ethernet virtual
	  driver for R-Car Gen3 SoCs.

	  To compile this driver as a module, choose M here: the module will
	  be called rcar_taurus_ether.
```

## drivers/soc/bcm/brcmstb/Kconfig
```kconfig
if SOC_BRCMSTB

config BRCMSTB_PM
	bool "Support suspend/resume for STB platforms"
	default y
	depends on PM
	depends on ARM || BMIPS_GENERIC

endif # SOC_BRCMSTB
```

## drivers/soc/renesas/Kconfig
```kconfig
#
# Renesas SoC drivers
#
config RCAR_THERMAL_EMS_ENABLED
	tristate "Renesas R-Car Gen3 Enable Emergency Shutdown"
	depends on RCAR_GEN3_THERMAL
	help
	  Enable this option if you want to have support for Emergency Shutdown
	  in R-Car Gen3.

config RCAR_DDR_BACKUP
	bool "Renesas R-Car DDR backup/restore function"
	depends on SUSPEND
	default y
	help
	  This enables DDR backup function for R-Car Gen3.
	  It supports to backup/restore module register during suspend/resume
	  sequence respectively when system enters S2RAM.
```
