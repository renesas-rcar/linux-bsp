## drivers/gpu/drm/renesas/rcar-vcon/Kconfig
```kconfig
# SPDX-License-Identifier: GPL-2.0
config DRM_RCAR_VCON
	tristate "DRM Support for R-Car Video Interface Converter"
	depends on DRM && OF
	depends on ARM || ARM64
	depends on ARCH_RENESAS || COMPILE_TEST
	select DRM_KMS_HELPER
	select DRM_GEM_DMA_HELPER
	select VIDEOMODE_HELPERS
	select VIDEO_RENESAS_FCP
	select VIDEO_RENESAS_VSP1
	help
	  Enable support for the R-Car Video Interface Converter (VCON), the
	  display controller found on the Renesas R-Car Gen5 SoC.

	  Choose this option if you have an R-Car Gen5 SoC and want display
	  output support. If M is selected the module will be called
	  rcar_vcon_drm.

config DRM_RCAR_DW_DP
	tristate "R-Car DW DP Encoder Support"
	depends on DRM && DRM_BRIDGE && OF
	select DRM_DW_DP
	help
	  Enable support for the R-Car DisplayPort TX encoder, a wrapper
	  around the Synopsys DesignWare DisplayPort (DW-DP) controller as
	  integrated on the Renesas R-Car Gen5 SoC.

	  Choose this option if you have an R-Car Gen5 SoC with DisplayPort
	  outputs. If M is selected the module will be called rcar_dw_dp.
```

## drivers/media/i2c/dmc/Kconfig
```kconfig
#
# DMC video device configuration
#

config VIDEO_CXD4963
	tristate "Sony CXD4963 deserializer support"
	depends on I2C && I2C_MUX && VIDEO_V4L2
	select MEDIA_CONTROLLER
	select VIDEO_V4L2_SUBDEV_API
	select V4L2_FWNODE
	default y
	help
	  This driver supports the Sony CXD4963 serializer

	  To compile this driver as a module, choose M here: the
	  module will be called CXD4963.

config VIDEO_DMC_IMAGER
	tristate "DMC image sensor support"
	depends on I2C && I2C_MUX && VIDEO_V4L2
	select MEDIA_CONTROLLER
	select VIDEO_V4L2_SUBDEV_API
	select V4L2_FWNODE
	default y
	help
	  This is a Video4Linux2 sensor driver for the Sony
	  camera.

	  To compile this driver as a module, choose M here: the
	  module will be called DMC_IMAGER.
```

## drivers/media/platform/renesas/rcar-vin/Kconfig
```kconfig
# SPDX-License-Identifier: GPL-2.0
config VIDEO_RCAR_VIN
	tristate "R-Car Video Input (VIN) Driver"
	depends on V4L_PLATFORM_DRIVERS
	depends on VIDEO_DEV && OF
	depends on ARCH_RENESAS || COMPILE_TEST
	select MEDIA_CONTROLLER
	select VIDEO_V4L2_SUBDEV_API
	select RESET_CONTROLLER
	select VIDEOBUF2_DMA_CONTIG
	select V4L2_FWNODE
	help
	  Support for Renesas R-Car Video Input (VIN) driver.
	  Supports R-Car Gen{2,3} and RZ/G{1,2} SoCs.

	  To compile this driver as a module, choose M here: the
	  module will be called rcar-vin.

config VIDEO_RCAR_VIN_DEBUG
	bool "R-Car VIN overflow debug messages"
	depends on VIDEO_RCAR_VIN
	help
	  Enable debug overflow messages on R-Car Video
	  Input driver.
	  If you set to enable, When an overflow occurred,
	  a debug overflow message is output.

config VIDEO_SNPS_CSI2_CAMERA
	bool "Synopsys CSI-2 Camera Driver"
	depends on VIDEO_RCAR_CSI2
	help
	  Dummy Driver for Synopsys CSI-2 Camera
	  model on VDK.

config VIDEO_RCAR_VIN_VDK
	bool "R-Car VIN Driver for VDK simulation"
	depends on VIDEO_RCAR_VIN
	help
	  Enable R-Car Video Input driver on VDK environment.
```

## drivers/misc/emc/Kconfig
```kconfig
config EMC_BZ
	tristate "EMC Buzzer control driver"
	depends on ARCH_RENESAS || COMPILE_TEST
	default y

config EMC_HT
	tristate "EMC Heater control driver"
	depends on ARCH_RENESAS || COMPILE_TEST
	default y

config EMC_IG
	tristate "EMC IG_DET control driver"
	depends on ARCH_RENESAS || COMPILE_TEST
	default y

config EMC_DSM
	tristate "EMC DSM control driver"
	depends on ARCH_RENESAS || COMPILE_TEST
	default y

config EMC_DATA
	tristate "EMC DATA interface driver"
	depends on ARCH_RENESAS || COMPILE_TEST
	default y

config EMC_TEMP
	tristate "EMC TEMPERATURE interface driver"
	depends on ARCH_RENESAS || COMPILE_TEST
	default y
```
