## Documentation/devicetree/bindings/pinctrl/renesas,rza1-pinctrl.txt
```
Renesas RZ/A1 combined Pin and GPIO controller

Renesas SoCs of RZ/A1 family feature a combined Pin and GPIO controller
hardware controller, named "Ports" in the hardware reference manual.
Pin multiplexing and GPIO configuration is performed on a per-pin basis
writing configuration values to per-port register sets.
Each "port" features up to 16 pins, each of them configurable for GPIO
function (port mode) or in alternate function mode.
Up to 8 different alternate function modes exist for each single pin.

Pin controller node
-------------------

Required properties:
  - compatible
    this shall be "renesas,r7s72100-ports".

  - #pinctrl-cells
    as defined by pinctrl-bindings.txt, this is the number
    of cells (in addition to pin index) required to configure a single pin.
    Shall be set to 1.

  - reg
    address base and length of the memory area where pin controller
    hardware is mapped to.

Example:
Pin controller node for RZ/A1H SoC (r7s72100)

pinctrl: pinctrl@fcfe3000 {
	compatible = "renesas,r7s72100-ports";

	#pinctrl-cells = <1>;

	reg = <0xfcfe3000 0x4248>;
};

Sub-nodes
---------

The child nodes of the pin controller node describe a pin multiplexing
function or a gpio controller alternatively.

- Pin multiplexing sub-nodes:
  A pin multiplexing sub-node describes how to configure a set of
  (or a single) pin in some desired alternate function mode.
  A single sub-node may define several pin configurations groups.

  Required properties:
    - renesas,pins
      describes an array of pin multiplexing configurations.
      When a pin has to be configured in alternate function mode, use this
      property to identify the pin by its global index, and provide its
      alternate function configuration description along with it.
      When multiple pins are required to be configured as part of the same
      alternate function (odds are single-pin alternate functions exist) they
      shall be specified as members of the same argument list of a single
      "renesas-pins" property.
      Helper macros to ease calculating the pin index from its position
      (port where it sits on and pin offset), and alternate function
      configuration options are provided in pin controller header file at:
      include/dt-bindings/pinctrl/r7s72100-pinctrl.h

  Example:
  A serial communication interface with a TX output pin and a RX input pin.

  &pinctrl {
	scif2_pins: serial2 {
		renesas,pins = <PIN(3, 0) 6>,
			       <PIN(3, 2) 4>;
	};
  }

  Pin #0 on port #3 is configured in alternate function #6.
  Pin #2 on port #3 is configured in alternate function #4.

  Example 2:
  I2c master: both SDA and SCL pins need bi-directional operations

  &pinctrl {
	i2c2_pins: i2c2 {
		renesas,pins = <PIN(1, 4) (1 | BI_DIR)>,
			       <PIN(1, 5) (1 | BI_DIR)>;
	};
  }

  Pin #4 on port #1 is configured in alternate function #1.
  Pin #5 on port #1 is configured in alternate function #1.
  Both need to work in bi-directional mode.

  Example 3:
  Multi-function timer input and output compare pins.
  The hardware manual prescribes this pins to have input/output direction
  specified by software. Configure TIOC0A as input and TIOC0B as output.

  &pinctrl {
	tioc0_pins: tioc0 {
		renesas,pins = <PIN(4, 0) (2 | SWIO_IN)>,
			       <PIN(4, 1) (2 | SWIO_OUT)>;
	};
  }

  Pin #0 on port #4 is configured in alternate function #2 with IO direction
  specified by software as input.
  Pin #1 on port #4 is configured in alternate function #1 with IO direction
  specified by software as output.

- GPIO controller sub-nodes:
  Each port of r7s72100 pin controller hardware is itself a gpio controller.
  Different SoCs have different number of available pins per port, but
  generally speaking, each of them can be configured in GPIO ("port") mode
  on this hardware.
  Describe gpio-controllers using sub-nodes with the following properties.

  Required properties:
    - gpio-controller
      empty property as defined by gpio bindings documentation.
    - #gpio-cells
      number of cells required to identify and configure a GPIO.
      Shall be 2.
    - gpio-ranges
      Describes a gpio controller specifying its specific pin base, the pin
      base in the global pin numbering space, and the number of controlled
      pins, as defined by gpio bindings documentation. Refer to this file
      for a more detailed description.

  Example:
  A gpio controller node, controlling 16 pins indexed from 0.
  The gpio controller base in the global pin indexing space is pin 48, thus
  pins [0 - 15] on this controller map to pins [48 - 63] in the global pin
  indexing space.

  port3: gpio-3 {
	gpio-controller;
	#gpio-cells = <2>;
	gpio-ranges = <&pinctrl 0 48 16>;
  };

  A device node willing to use pins controlled by this gpio controller, shall
  refer to it as follows:

  led1 {
	gpios = <&port3 10 GPIO_ACTIVE_LOW>;
  };
```

## Documentation/devicetree/bindings/soc/renesas/renesas,rcar-gen5-crc.yaml
```yaml
# SPDX-License-Identifier: (GPL-2.0-only OR BSD-2-Clause)
%YAML 1.2
---
$id: http://devicetree.org/schemas/soc/renesas/renesas,rcar-gen5-crc.yaml#
$schema: http://devicetree.org/meta-schemas/core.yaml#

title: Renesas R-Car Gen5 CRC (Cyclic Redundancy Check) Controller

maintainers:
  - Huy Bui <huy.bui.wm@renesas.com>

properties:
  compatible:
    const: renesas,rcar-gen5-crc

  reg:
    maxItems: 1

  clocks:
    maxItems: 1

  clock-names:
    items:
      - const: fck

required:
  - compatible
  - reg
  - clocks
  - clock-names

additionalProperties: false

examples:
  - |
    crc0: crc@19000000 {
        compatible = "renesas,rcar-gen5-crc";
        reg = <0x19000000 0x00010000>;
        clocks = <&cpg_clk 0>;
        clock-names = "fck";
    };
```

## Documentation/devicetree/bindings/soc/renesas/renesas,rcar-gen5-kcrc.yaml
```yaml
# SPDX-License-Identifier: (GPL-2.0-only OR BSD-2-Clause)
%YAML 1.2
---
$id: http://devicetree.org/schemas/soc/renesas/renesas,rcar-gen5-kcrc.yaml#
$schema: http://devicetree.org/meta-schemas/core.yaml#

title: Renesas R-Car Gen5 KCRC (Cyclic Redundancy Check) Controller

maintainers:
  - Huy Bui <huy.bui.wm@renesas.com>

properties:
  compatible:
    const: renesas,rcar-gen5-kcrc

  reg:
    maxItems: 1

  clocks:
    maxItems: 1

  clock-names:
    items:
      - const: fck

required:
  - compatible
  - reg
  - clocks
  - clock-names

additionalProperties: false

examples:
  - |
    kcrc0: kcrc@19100000 {
        compatible = "renesas,rcar-gen5-kcrc";
        reg = <0x19100000 0x00010000>;
        clocks = <&cpg_clk 0>;
        clock-names = "fck";
    };
```

## Documentation/devicetree/bindings/soc/renesas/renesas,rcar-gen5-wcrc.yaml
```yaml
# SPDX-License-Identifier: (GPL-2.0-only OR BSD-2-Clause)
%YAML 1.2
---
$id: http://devicetree.org/schemas/soc/renesas/renesas,rcar-gen5-wcrc.yaml#
$schema: http://devicetree.org/meta-schemas/core.yaml#

title: Renesas R-Car Gen5 WCRC (CRC Wrapper) Controller

maintainers:
  - Huy Bui <huy.bui.wm@renesas.com>

description:
  The WCRC wraps a pair of CRC and KCRC sub-modules and drives data
  to/from them through DMA, in addition to direct register access.

properties:
  compatible:
    const: renesas,rcar-gen5-wcrc

  reg:
    items:
      - description: WCRC register region
      - description: FIFO register region

  reg-names:
    items:
      - const: wcrc
      - const: fifo

  sub-crc:
    $ref: /schemas/types.yaml#/definitions/phandle
    description: phandle to the CRC sub-module used by this WCRC instance.

  sub-kcrc:
    $ref: /schemas/types.yaml#/definitions/phandle
    description: phandle to the KCRC sub-module used by this WCRC instance.

  interrupts:
    maxItems: 1

  clocks:
    maxItems: 1

  clock-names:
    items:
      - const: fck

  dmas:
    minItems: 8
    maxItems: 32

  dma-names:
    minItems: 8
    maxItems: 32

required:
  - compatible
  - reg
  - reg-names
  - sub-crc
  - sub-kcrc
  - interrupts
  - clocks
  - clock-names
  - dmas
  - dma-names

additionalProperties: false

examples:
  - |
    wcrc0: wcrc@19200000 {
        compatible = "renesas,rcar-gen5-wcrc";
        reg = <0x19200000 0x00010000>,
              <0x19400000 0x4000>;
        reg-names = "wcrc", "fifo";
        sub-crc = <&crc0>;
        sub-kcrc = <&kcrc0>;
        interrupts = <0x00 0x106f 0x04>;
        clocks = <&cpg_clk 0>;
        clock-names = "fck";
        dmas = <&rt_dmac0 0x18>, <&rt_dmac0 0x19>,
               <&rt_dmac0 0x1a>, <&rt_dmac0 0x1b>,
               <&rt_dmac0 0x1c>, <&rt_dmac0 0x1d>,
               <&rt_dmac0 0x1e>, <&rt_dmac0 0x1f>;
        dma-names = "crc_rx", "crc_tx", "crc_rx_in", "crc_txrx",
                    "kcrc_rx", "kcrc_tx", "kcrc_rx_in", "kcrc_txrx";
    };
```

## Documentation/devicetree/bindings/ufs/renesas,rcar-gen5-ufs.yaml
```yaml
# SPDX-License-Identifier: (GPL-2.0-only OR BSD-2-Clause)
%YAML 1.2
---
$id: http://devicetree.org/schemas/ufs/renesas,rcar-gen5-ufs.yaml#
$schema: http://devicetree.org/meta-schemas/core.yaml#

title: Renesas R-Car UFS Host Controller for R-Car Gen5

maintainers:
  - Yoshihiro Shimoda <yoshihiro.shimoda.uh@renesas.com>

allOf:
  - $ref: ufs-common.yaml

properties:
  compatible:
    items:
      - enum:
          - renesas,r8a78000-ufs     # R-Car X5H
      - const: renesas,rcar-gen5-ufs

  reg:
    maxItems: 2

  reg-names:
    items:
      - const: phy
      - const: hcr

  clocks:
    maxItems: 1

  clock-names:
    items:
      - const: ref_clk

required:
  - compatible
  - reg
  - reg-names
  - clocks
  - clock-names

unevaluatedProperties: false

examples:
  - |
    #include <dt-bindings/interrupt-controller/arm-gic.h>

    ufs0: ufs@c0a80000 {
        compatible = "renesas,r8a78000-ufs", "renesas,rcar-gen5-ufs";
        reg = <0xc0a80000 0x1100>, <0xc0a00000, 0x40000>;
        reg-names = "hcr", "phy";
        interrupts = <GIC_SPI 4284 IRQ_TYPE_LEVEL_HIGH>;
        clocks = <&ufs40_clk>;
        clock-names = "ref_clk";
        freq-table-hz = <200000000 200000000>, <38400000 38400000>;
    };
```
