## Documentation/devicetree/bindings/display/bridge/ti,tdp2004.yaml
```yaml
# SPDX-License-Identifier: (GPL-2.0-only OR BSD-2-Clause)
%YAML 1.2
---
$id: http://devicetree.org/schemas/display/bridge/ti,tdp2004.yaml#
$schema: http://devicetree.org/meta-schemas/core.yaml#

title: Texas Instruments TDP2004 DisplayPort Redriver

maintainers:
  - TBD

description:
  The TDP2004 is an I2C-controlled DisplayPort 1.2 linear redriver used to
  recondition the high-speed lanes between a DisplayPort source and connector.

properties:
  compatible:
    const: ti,tdp2004

  reg:
    maxItems: 1

  enable-gpios:
    maxItems: 1
    description: GPIO connected to the device enable pin.

required:
  - compatible
  - reg

additionalProperties: false

examples:
  - |
    #include <dt-bindings/gpio/gpio.h>

    i2c {
        #address-cells = <1>;
        #size-cells = <0>;

        redriver@18 {
            compatible = "ti,tdp2004";
            reg = <0x18>;
            enable-gpios = <&gpio9 14 GPIO_ACTIVE_LOW>;
        };
    };
```

## Documentation/devicetree/bindings/display/renesas,dw-dp.yaml
```yaml
# SPDX-License-Identifier: (GPL-2.0-only OR BSD-2-Clause)
%YAML 1.2
---
$id: http://devicetree.org/schemas/display/renesas,dw-dp.yaml#
$schema: http://devicetree.org/meta-schemas/core.yaml#

title: Renesas R-Car DesignWare DisplayPort TX

maintainers:
  TBD

description:
  The DT bindings describes the DisplayPort TX (DP-TX) embedded in
  the Renesas R-Car Gen5 SoC.

properties:
  compatible:
    enum:
      - renesas,r8a78000-dw-dp     # R-Car X5H

  reg:
    items:
      - description: DP-TX registers
      - description: Firmware memory
      - description: PHY registers

  reg-names:
    items:
      - const: io_base
      - const: fw
      - const: phy

  interrupts:
    maxItems: 1

  clocks:
    maxItems: 1

  resets:
    maxItems: 1

  power-domains:
    minItems: 1
    maxItems: 2

  ports:
    $ref: /schemas/graph.yaml#/properties/ports
    description:
      The input connections from the VCON, one port per stream.

required:
  - compatible
  - reg
  - reg-names
  - interrupts
  - clocks
  - power-domains
  - ports

additionalProperties: false

examples:
  - |
    #include <dt-bindings/interrupt-controller/arm-gic.h>

    dp@c5400000 {
        compatible = "renesas,r8a78000-dw-dp";
        reg = <0xc5400000 0x60000>,
              <0xc5460000 0x20000>,
              <0xc5480000 0x80000>;
        reg-names = "io_base", "fw", "phy";
        interrupts = <GIC_SPI 4309 IRQ_TYPE_LEVEL_HIGH>;
        clocks = <&scmi_clk 0>;
        resets = <&scmi_reset 0>;
        power-domains = <&scmi_devpd 0>, <&scmi_devpd 1>;

        ports {
            #address-cells = <1>;
            #size-cells = <0>;

            port@0 {
                reg = <0>;
                dw_dp0_0_in: endpoint {
                    remote-endpoint = <&vcon_out_dp0_0>;
                };
            };
        };
    };
```

## Documentation/devicetree/bindings/display/renesas,vcon.yaml
```yaml
# SPDX-License-Identifier: (GPL-2.0-only OR BSD-2-Clause)
%YAML 1.2
---
$id: http://devicetree.org/schemas/display/renesas,vcon.yaml#
$schema: http://devicetree.org/meta-schemas/core.yaml#

title: Renesas R-Car Video Interface Converter (VCON)

maintainers:
  - TBD

description:
  These DT bindings describes the Video Interface Converter (VCON) embedded
  in the Renesas R-Car Gen5 SoC.

properties:
  compatible:
    enum:
      - renesas,r8a78000-vcon     # R-Car X5H

  reg:
    minItems: 1
    maxItems: 4

  interrupts:
    minItems: 1
    maxItems: 4

  interrupt-names:
    minItems: 1
    items:
      - const: ch0
      - const: ch1
      - const: ch2
      - const: ch3

  clocks:
    minItems: 1
    maxItems: 4

  clock-names:
    minItems: 1
    items:
      - const: dclkin.0
      - const: dclkin.1
      - const: dclkin.2
      - const: dclkin.3

  resets:
    minItems: 1
    maxItems: 4

  power-domains:
    maxItems: 1

  channels:
    description: Number of display channels provided by this VCON instance.
    minimum: 1
    maximum: 4

  renesas,dclk-rate:
    description: Dot clock rate in Hz used to drive the display channels.

  renesas,vsps:
    description:
      A list of phandle and channel index tuples to the VSPs that handle the
      memory interface for the display channels.
    items:
      items:
        - description: phandle to the VSP entity
        - description: channel index in the VSP

  ports:
    $ref: /schemas/graph.yaml#/properties/ports
    description:
      The connections to the DisplayPort encoders, one port per channel.

  i2c-bus:
    type: object
    description: >
      Empty i2c-bus subnode so DP-MST's I2C-over-AUX adapters (which use this
      node as of_node) don't make of_i2c scan the OF-graph "ports" node
      ("of_i2c: modalias failure").

required:
  - compatible
  - reg
  - interrupts
  - clocks
  - power-domains
  - renesas,vsps
  - ports

additionalProperties: false

examples:
  - |
    #include <dt-bindings/interrupt-controller/arm-gic.h>

    display@c5020000 {
        compatible = "renesas,r8a78000-vcon";
        reg = <0xc5020000 0x1000>,
              <0xc5021000 0x1000>,
              <0xc5022000 0x1000>,
              <0xc5023000 0x1000>;
        interrupts = <GIC_SPI 665 IRQ_TYPE_LEVEL_HIGH>,
                     <GIC_SPI 666 IRQ_TYPE_LEVEL_HIGH>,
                     <GIC_SPI 667 IRQ_TYPE_LEVEL_HIGH>,
                     <GIC_SPI 668 IRQ_TYPE_LEVEL_HIGH>;
        interrupt-names = "ch0", "ch1", "ch2", "ch3";
        clocks = <&scmi_clk 0>, <&scmi_clk 1>,
                 <&scmi_clk 2>, <&scmi_clk 3>;
        clock-names = "dclkin.0", "dclkin.1", "dclkin.2", "dclkin.3";
        power-domains = <&scmi_devpd 0>;
        renesas,dclk-rate = <550000000>;
        channels = <4>;
        renesas,vsps = <&vspd0 0>, <&vspd1 0>, <&vspd2 0>, <&vspd3 0>;

        ports {
            #address-cells = <1>;
            #size-cells = <0>;

            port@0 {
                reg = <0>;
                vcon_out_dp0_0: endpoint {
                    remote-endpoint = <&dw_dp0_0_in>;
                };
            };
        };
    };
```

## Documentation/devicetree/bindings/hwlock/rcar-hwspinlock.yaml
```yaml
# SPDX-License-Identifier: (GPL-2.0-only OR BSD-2-Clause)
%YAML 1.2
---
$id: http://devicetree.org/schemas/hwlock/rcar-hwspinlock.yaml#
$schema: http://devicetree.org/meta-schemas/core.yaml#

title: Renesas R-Car Hardware spinlock

maintainers:
  - T.B.D

description:
  The hardware block provides mutexes utilized between different processors on
  the SoC as part of the communication protocol used by these processors.

properties:
  compatible:
    oneOf:
      - enum:
          - renesas,mfis-lock
      - items:
          - enum:
              - renesas,mfis-lock-r8a77951
              - renesas,mfis-lock-r8a77960
              - renesas,mfis-lock-r8a77961
              - renesas,mfis-lock-r8a77965
              - renesas,mfis-lock-r8a77990
              - renesas,mfis-lock-r8a77995
              - renesas,mfis-lock-r8a78000
          - const:
	      - renesas,mfis-lock
	      - renesas,mfis-lock-gen5

  reg:
    maxItems: 2
    items:
      - description: the IO base of MFIS-Lock registers
      - description: the register of MFIS-Lock write protection disable/enable

  reg-names:
    items:
      - const: io_base
      - const: unlock_reg

  '#hwlock-cells':
    const: 1

required:
  - compatible
  - reg
  - '#hwlock-cells'

additionalProperties: false

examples:
  - |
    mfis: mfis@e6260000 {
        compatible = "renesas,mfis-lock-r8a77951",
		     "renesas,mfis-lock";
        reg = <0 0xe6260000 0 0x1000>;
        #hwlock-cells = <1>;
    };

  - |
    mfis_lock@189e0000 {
        compatible = "renesas,mfis-lock-r8a78000",
		     "renesas,mfis-lock-gen5";
        reg = <0 0x189e0000 0 0x900>, <0x0 0x189e0900 0x0 0x4>;
        reg-names = "io_base", "unlock_reg";
        #hwlock-cells = <1>;
    };
...
```

## Documentation/devicetree/bindings/i3c/renesas,i3c-rcar-master.yaml
```yaml
# SPDX-License-Identifier: (GPL-2.0-only OR BSD-2-Clause)
%YAML 1.2
---
$id: http://devicetree.org/schemas/i3c/renesas,i3c-rcar.yaml#
$schema: http://devicetree.org/meta-schemas/core.yaml#

title: Renesas R-Car I3C master/target

maintainers:
  - Minh Le <minh.le.aj@renesas.com>

allOf:
  - $ref: i3c.yaml#

properties:
  compatible:
    const: renesas,rcar-i3c-master

  reg:
    maxItems: 1

  interrupts:
    maxItems: 1

  clocks:
    items:
      - description: APB bus clock
      - description: transfer clock

  clock-names:
    items:
      - const: pclk
      - const: tclk

  resets:
    maxItems: 1

required:
  - compatible
  - reg
  - interrupts
  - clock-names
  - clocks

unevaluatedProperties: false
```

## Documentation/devicetree/bindings/media/i2c/onnn,ar0820.yaml
```yaml
# SPDX-License-Identifier: (GPL-2.0-only OR BSD-2-Clause)
%YAML 1.2
---
$id: http://devicetree.org/schemas/media/i2c/onnn,ar0820.yaml#
$schema: http://devicetree.org/meta-schemas/core.yaml#

title: ON Semiconductor AR0820 CMOS Image Sensor

maintainers:
  - Linh Phung <linh.phung.jy@renesas.com>

description: |
  The AR0820 is a raw CMOS image sensor. In the boards of this repository it
  is connected via a Maxim GMSL serializer/deserializer link (e.g.
  MAX96793/MAX96712/MAX96726) rather than directly to the SoC's CSI-2
  receiver.

  This binding only describes the devicetree node's compatible/reg/port, as
  used by the boards in this repository. The v4l2 subdev driver that binds
  this compatible is not part of this kernel tree: it is maintained
  out-of-tree in the "gmsl_serdes" project, built and installed as a
  separate kernel module alongside the deserializer driver.

properties:
  compatible:
    const: onnn,ar0820

  reg:
    maxItems: 1

  maxim,sensor-remote-i2c-addr:
    description:
      7-bit I2C address of the remote image sensor before GMSL address
      translation.
    $ref: /schemas/types.yaml#/definitions/uint32
    minimum: 8
    maximum: 119

  port:
    $ref: /schemas/graph.yaml#/$defs/port-base
    unevaluatedProperties: false

    properties:
      endpoint:
        $ref: /schemas/media/video-interfaces.yaml#
        unevaluatedProperties: false

    required:
      - endpoint

required:
  - compatible
  - reg
  - port

additionalProperties: false

examples:
  - |
    i2c {
        #address-cells = <1>;
        #size-cells = <0>;

        camera@49 {
            compatible = "onnn,ar0820";
            reg = <0x49>;
            maxim,sensor-remote-i2c-addr = <0x10>;

            port {
                endpoint {
                    remote-endpoint = <&max96726_in0>;
                };
            };
        };
    };
```

## Documentation/devicetree/bindings/media/i2c/sony,imx623.yaml
```yaml
# SPDX-License-Identifier: (GPL-2.0-only OR BSD-2-Clause)
%YAML 1.2
---
$id: http://devicetree.org/schemas/media/i2c/sony,imx623.yaml#
$schema: http://devicetree.org/meta-schemas/core.yaml#

title: Sony IMX623 CMOS Image Sensor

maintainers:
  - Linh Phung <linh.phung.jy@renesas.com>

description: |
  The Sony IMX623 is a CMOS image sensor connected via a Maxim GMSL2
  serializer/deserializer link (e.g. MAX96717/MAX96712/MAX96726) rather than
  directly to the SoC's CSI-2 receiver.

  This binding only describes the devicetree node's compatible/reg/port, as
  used by the boards in this repository. The v4l2 subdev driver that binds
  this compatible is not part of this kernel tree: it is maintained
  out-of-tree in the "gmsl_serdes" project, built and installed as a
  separate kernel module alongside the deserializer driver.

properties:
  compatible:
    const: sony,imx623

  reg:
    maxItems: 1

  port:
    $ref: /schemas/graph.yaml#/$defs/port-base
    unevaluatedProperties: false

    properties:
      endpoint:
        $ref: /schemas/media/video-interfaces.yaml#
        unevaluatedProperties: false

    required:
      - endpoint

required:
  - compatible
  - reg
  - port

additionalProperties: false

examples:
  - |
    camera@59 {
        compatible = "sony,imx623";
        reg = <0x59>;

        port {
            endpoint {
                remote-endpoint = <&max96726_in2>;
            };
        };
    };
```

## Documentation/devicetree/bindings/net/renesas,r8a78000-ethertsn.yaml
```yaml
# SPDX-License-Identifier: GPL-2.0-only OR BSD-2-Clause
%YAML 1.2
---
$id: http://devicetree.org/schemas/net/renesas,r8a78000-ethertsn.yaml#
$schema: http://devicetree.org/meta-schemas/core.yaml#

title: Renesas R-Car Gen5 Ethernet TSN End Station Controller

properties:
  compatible:
    const: renesas,r8a78000-ethertsn

  reg:
    maxItems: 2

  reg-names:
    items:
      - const: tsnes
      - const: gptp

  interrupts:
    maxItems: 5

  interrupt-names:
    items:
      - const: status
      - const: tx
      - const: rx
      - const: ts
      - const: error

  power-domains:
    maxItems: 1

  clocks:
    maxItems: 2

  clock-names:
    items:
      - const: rsw3tsn
      - const: tsnes

  renesas,gptp-domain:
    description: GPTP domain identifier.
    $ref: /schemas/types.yaml#/definitions/string

  phy-mode:
    const: gmii

  max-speed:
    const: 2500

  renesas,tsnes-id:
    description: TSN-ES instance ID.
    $ref: /schemas/types.yaml#/definitions/uint32

  renesas,rswitch:
    description: Phandle to the R-Switch3 controller.
    $ref: /schemas/types.yaml#/definitions/phandle

  renesas,rswitch-if:
    description: R-Switch3 internal interface index connected to this TSN-ES.
    $ref: /schemas/types.yaml#/definitions/uint32

  renesas,rswitch-forward-ports:
    description: R-Switch3 external forwarding port bitmap or port index.
    $ref: /schemas/types.yaml#/definitions/uint32

  fixed-link:
    $ref: ethernet-controller.yaml#/properties/fixed-link

required:
  - compatible
  - reg
  - reg-names
  - interrupts
  - interrupt-names
  - power-domains
  - clocks
  - clock-names
  - phy-mode
  - max-speed
  - renesas,tsnes-id
  - renesas,rswitch
  - renesas,rswitch-if
  - fixed-link

additionalProperties: false

examples:
  - |
    #include <dt-bindings/interrupt-controller/arm-gic.h>

    ethernet@c9c6c000 {
        compatible = "renesas,r8a78000-ethertsn";
        reg = <0 0xc9c6c000 0 0x4000>,
              <0 0xc9ca3000 0 0x800>;
        reg-names = "tsnes", "gptp";
        interrupts = <GIC_SPI 853 IRQ_TYPE_LEVEL_HIGH>,
                     <GIC_SPI 854 IRQ_TYPE_LEVEL_HIGH>,
                     <GIC_SPI 855 IRQ_TYPE_LEVEL_HIGH>,
                     <GIC_SPI 856 IRQ_TYPE_LEVEL_HIGH>,
                     <GIC_SPI 857 IRQ_TYPE_LEVEL_HIGH>;
        interrupt-names = "status", "tx", "rx", "ts", "error";
        power-domains = <&scmi_devpd 0>;
        clocks = <&scmi_clk 0>, <&scmi_clk 1>;
        clock-names = "rsw3tsn", "tsnes";
        renesas,gptp-domain = "a";
        phy-mode = "gmii";
        max-speed = <2500>;
        renesas,tsnes-id = <3>;
        renesas,rswitch = <&rswitch3>;
        renesas,rswitch-if = <8>;
        renesas,rswitch-forward-ports = <4>;
        fixed-link {
            speed = <2500>;
            full-duplex;
        };
    };
...
```
